## CMakeLists.txt
```
cmake_minimum_required(VERSION 3.20.0)
#list(APPEND BOARD_ROOT ${CMAKE_CURRENT_SOURCE_DIR}/../../)
list(APPEND SNIPPET_ROOT ${CMAKE_CURRENT_SOURCE_DIR})
find_package(Zephyr REQUIRED HINTS $ENV{ZEPHYR_BASE})
project(hello_world)

target_sources(app PRIVATE src/main.c)

# When the `rram` snippet is selected, the SoC's signing helper
# (pse84_add_metadata_secure_hex) still emits zephyr.signed.hex at
# the SMIF-SAHB address 0x70100000 because it derives --hex-addr
# from the board's `m33s_header`/`flash0_s`/`flash0_sahb` DT nodes.
# Rebase every IHEX extended-address record to RRAM-S 0x32011000
# (delta -0x3E0EF000) so OpenOCD's RRAM flash bank programs the
# correct memory. Payload bytes (vector table, MCUBoot header,
# hash, signature TLVs) are untouched, so SE-ROM signature
# verification still passes.
#
# We attach via add_custom_target(... ALL) with a file-level
# DEPENDS on signed.hex instead of `extra_post_build_commands`
# because that property is snapshotted by Zephyr's top-level
# CMakeLists during find_package(Zephyr).
if("rram" IN_LIST SNIPPET_AS_LIST)
  set(_signed_hex ${ZEPHYR_BINARY_DIR}/${KERNEL_NAME}.signed.hex)
  set(_signed_hex_stamp ${_signed_hex}.rram.stamp)
  add_custom_command(
    OUTPUT ${_signed_hex_stamp}
    COMMAND ${CMAKE_COMMAND} -E echo
            "Shifting zephyr.signed.hex from SMIF-S 0x70100000 to RRAM-S 0x32011000"
    COMMAND ${CMAKE_OBJCOPY}
            --input-target=ihex
            --output-target=ihex
            --change-addresses=-0x3E0EF000
            ${_signed_hex}
            ${_signed_hex}.tmp
    COMMAND ${CMAKE_COMMAND} -E rename ${_signed_hex}.tmp ${_signed_hex}
    COMMAND ${CMAKE_COMMAND} -E touch ${_signed_hex_stamp}
    DEPENDS ${_signed_hex}
    COMMENT "Retargeting zephyr.signed.hex SMIF-S -> RRAM-S"
  )
  add_custom_target(retarget_signed_hex_to_rram ALL
    DEPENDS ${_signed_hex_stamp}
  )
endif()
```

## prj.conf
```kconfig
CONFIG_BUILD_OUTPUT_HEX=y
#CONFIG_ONOFF=y
```

## src/main.c
```c
/*
 * Copyright (c) 2016 Intel Corporation
 *
 * SPDX-License-Identifier: Apache-2.0
 */

#include <stdio.h>
#include <zephyr/kernel.h>
#include <zephyr/drivers/gpio.h>
#include <zephyr/device.h>
#include <zephyr/drivers/clock_control/clock_control_ifx_cat1.h>
#include <zephyr/sys/onoff.h>

/* 1000 msec = 1 sec */
#define SLEEP_TIME_MS   1000

/* The devicetree node identifier for the "led0" alias. */
#define LED0_NODE DT_ALIAS(led0)

/*
 * A build error on this line means your board is unsupported.
 * See the sample documentation for information on how to fix this.
 */
static const struct gpio_dt_spec led = GPIO_DT_SPEC_GET(LED0_NODE, gpios);


int main(void)
{	const struct device *clk_hf10 = DEVICE_DT_GET(DT_NODELABEL(clk_hf10));
	struct onoff_manager *mgr = ifx_clock_get_onoff_manager(clk_hf10);
	
	struct onoff_client cli;
	int rc, res;
	sys_notify_init_spinwait(&cli.notify);

    	rc = onoff_request(mgr, &cli);
    	if (rc < 0) {
        	return rc;
    	}

    	while (sys_notify_fetch_result(&cli.notify, &res) == -EAGAIN) {
        	k_yield();
    	}

    	if (res < 0) {
        	return res;
    	}

	printf("Hello World! %s\n", CONFIG_BOARD);
	int ret;
	bool led_state = true;

	if (!gpio_is_ready_dt(&led)) {
	 	return 0;
	 }

	ret = gpio_pin_configure_dt(&led, GPIO_OUTPUT_ACTIVE);
	if (ret < 0) {
		return 0;
	}

	ret = gpio_pin_toggle_dt(&led);
	led_state = !led_state;
	rc = onoff_release(mgr);


	/*while (1) {
		ret = gpio_pin_toggle_dt(&led);
		if (ret < 0) {
	 		return 0;
	 	}

	 	led_state = !led_state;
	 	printf("LED state: %s\n", led_state ? "ON" : "OFF");
	 	k_msleep(SLEEP_TIME_MS);
	 }*/
	 return 0;
}
```
