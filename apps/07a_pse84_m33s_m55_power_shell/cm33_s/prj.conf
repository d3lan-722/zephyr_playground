## CMakeLists.txt
```
cmake_minimum_required(VERSION 3.20.0)

# Register the app-local snippets/ dir so the `rram` snippet (used
# to link the image against the internal RRAM code region instead of
# the board-default SMIF XIP partition) is discoverable via
# `west build --snippet rram`. Must go BEFORE find_package(Zephyr).
list(APPEND SNIPPET_ROOT ${CMAKE_CURRENT_SOURCE_DIR})

find_package(Zephyr REQUIRED HINTS $ENV{ZEPHYR_BASE})

project(pse84_m33s_m55_power_shell)

target_sources(app PRIVATE
    src/main.c
    src/pse84_boot_local.c
    src/pm_early_boot.c
    src/power_manager.c
    src/power_manager_pll_retune.c
    src/power_manager_hf0_divider.c
    src/pm_phase_log.c
    src/shell_cmds.c
    src/cmd_noidle.c
    src/cmd_sleep.c
    src/cmd_deep_sleep.c
    src/gpio_indicators.c
    src/diag.c
)

# When the `rram` snippet is selected, the SoC's signing helper
# (pse84_add_metadata_secure_hex) emits zephyr.signed.hex at the
# SMIF-SAHB base 0x60100000 for the m33-secure-only board variant
# (imgtool.py sign --hex-addr 0x60100000, derived from the board's
# m33s_header / flash0_s / flash0_sahb DT nodes).
# Rebase every IHEX extended-address record to RRAM-S 0x32011000
# (delta -0x2E0EF000) so OpenOCD's RRAM flash bank programs the
# correct memory. Payload bytes (vector table, MCUBoot header,
# hash, signature TLVs) are untouched, so SE-ROM signature
# verification still passes. Mirrors the setup in
# apps/06_pse84_m33_s_shell_ulp_lp_hp/CMakeLists.txt.
if("rram" IN_LIST SNIPPET_AS_LIST)
  set(_signed_hex ${ZEPHYR_BINARY_DIR}/${KERNEL_NAME}.signed.hex)
  set(_signed_hex_stamp ${_signed_hex}.rram.stamp)
  add_custom_command(
    OUTPUT ${_signed_hex_stamp}
    COMMAND ${CMAKE_COMMAND} -E echo
            "Shifting zephyr.signed.hex from SMIF-S 0x60100000 to RRAM-S 0x32011000"
    COMMAND ${CMAKE_OBJCOPY}
            --input-target=ihex
            --output-target=ihex
            --change-addresses=-0x2E0EF000
            ${_signed_hex}
            ${_signed_hex}.tmp
    COMMAND ${CMAKE_COMMAND} -E rename ${_signed_hex}.tmp ${_signed_hex}
    COMMAND ${CMAKE_COMMAND} -E touch ${_signed_hex_stamp}
    DEPENDS ${_signed_hex}
    COMMENT "Retargeting zephyr.signed.hex SMIF-S -> RRAM-S"
  )
  add_custom_target(retarget_signed_hex_to_rram ALL
    DEPENDS ${_signed_hex_stamp}
  )
endif()
```

## Kconfig
```
# App-level Kconfig for project 06.
#
# Zephyr's ARM_ON_ENTER_CPU_IDLE_HOOK symbol has no user prompt and
# can only be turned on via `select` from another Kconfig. Provide a
# thin app-visible wrapper so prj.conf can toggle it.

mainmenu "Options for pse84_m33_s_shell_ulp_lp_hp"

config APP_ENABLE_IDLE_HOOK
	bool "Enable ARM idle-entry hook (required by the `noidle` shell command)"
	default y
	select ARM_ON_ENTER_CPU_IDLE_HOOK
	help
	  Enables the z_arm_on_enter_cpu_idle() hook so the `noidle`
	  shell command in src/cmd_noidle.c can veto WFI in the idle
	  thread. With this off, `noidle on` is a no-op (idle keeps
	  entering WFI regardless of the flag).

source "Kconfig.zephyr"
```

## prj.conf
```kconfig
# Zephyr shell over the SCB UART console.
CONFIG_SHELL=y

# Shell serial backend: IRQ-driven RX. Lets the CPU stay in WFI
# indefinitely between keypresses instead of polling every
# CONFIG_SHELL_BACKEND_SERIAL_RX_POLL_PERIOD ms, which would produce
# a 100 Hz spike train on the PPK2 rail.
CONFIG_UART_INTERRUPT_DRIVEN=y
CONFIG_SHELL_BACKEND_SERIAL_API_INTERRUPT_DRIVEN=y

# Idle-hook so `noidle` can veto WFI (defined in Kconfig; selects
# ARM_ON_ENTER_CPU_IDLE_HOOK). Consumer is src/cmd_noidle.c.
CONFIG_APP_ENABLE_IDLE_HOOK=y

# Shell size trims -- keep the rram code region compact. Same set
# as project 06; drop these if `hp`/`lp`/`ulp` help text or history
# is wanted.
CONFIG_SHELL_HELP=n
CONFIG_SHELL_HISTORY=n
CONFIG_SHELL_METAKEYS=n
CONFIG_SHELL_VT100_COMMANDS=n
CONFIG_SHELL_TAB=n
CONFIG_SHELL_TAB_AUTOCOMPLETION=n

# GPIO for the three on-board RGB indicator LEDs and the P3.1
# pm-busy scope trigger.
CONFIG_GPIO=y

# 4 KiB main stack: LP/ULP transition unrolls SysPm callback
# lists + RRAM/ClkHf writes.
CONFIG_MAIN_STACK_SIZE=4096

# --- System timer ------------------------------------------------------
# LPTIMER (MCWDT0 on PILO, 32.768 kHz) instead of SysTick. SysTick
# would scale with HF0 across HP/LP/ULP; MCWDT runs off PILO which is
# independent of every HF clock and stays alive through CPU deep
# sleep -- so it also doubles as the DS wake source.
CONFIG_CORTEX_M_SYSTICK=n
CONFIG_INFINEON_LP_TIMER_PDL=y
CONFIG_SYS_CLOCK_HW_CYCLES_PER_SEC=32768

# --- No TF-M -----------------------------------------------------------
# CM33 runs as Secure directly; CM55 is released by our local
# pse84_boot_local. No TF-M SPE and no SRF/mailbox relay.
CONFIG_BUILD_WITH_TFM=n
# CONFIG_SOC_PSE84_M55_ENABLE deliberately NOT set: the upstream
# ifx_pse84_cm55_startup() called from soc_late_init_hook ends in
# for(;;), which would trap the CM33 forever. We call our own
# app_pse84_cm55_startup() from main() instead.

# --- Build outputs -----------------------------------------------------
CONFIG_BUILD_OUTPUT_HEX=y
```

## src/main.c
```c
/*
 * Copyright (c) 2026
 * SPDX-License-Identifier: Apache-2.0
 *
 * CM33-Secure shell-controlled active-power-mode demo -- bring-up.
 *
 * Derived from apps/06_pse84_m33_s_shell_ulp_lp_hp/src/main.c but
 * runs on the 01a dual-core scaffolding: this CM33-S image releases
 * CM55 (which parks in Cy_SysPm_CpuEnterDeepSleep) BEFORE starting
 * the shell. That second DEEPSLEEP requestor is what unblocks the
 * PWRMODE state machine on the `deep_sleep` shell command -- the
 * missing piece from project 06.
 *
 * Structural modules (unchanged from 06):
 *
 *   src/power_manager.[ch]       -- HP/LP/ULP transitions, PLL retune,
 *                                   clock-measurement probe.
 *   src/shell_cmds.[ch]          -- ulp / lp / hp / probe shell handlers.
 *   src/cmd_{noidle,sleep,deep_sleep}.c
 *                                -- noidle veto + WFI + SLEEPDEEP+WFI.
 *   src/gpio_indicators.[ch]     -- mode LEDs (led0 red, led1 green) +
 *                                   PM-busy scope trigger on P3.1.
 *   src/diag.[ch]                -- raw-SCB tracing + blue heartbeat.
 *   src/pm_early_boot.c          -- MCWDT0 reset (LPTIMER prereq).
 *   src/pse84_boot_local.[ch]    -- local copy of pse84_boot.c that
 *                                   releases CM55 and RETURNS, so the
 *                                   Zephyr scheduler stays alive.
 */

#include <stdio.h>

#include <zephyr/kernel.h>

#include "gpio_indicators.h"
#include "power_manager.h"
#include "pse84_boot_local.h"

int main(void)
{
	printf("CM33-S shell-power-mode on %s\n", CONFIG_BOARD);

	app_pse84_cm55_startup();
	printf("CM33-S: CM55 released (parking in deep sleep)\n");

	if (gpio_indicators_init() < 0) {
		printf("CM33-S: GPIO indicators init failed\n");
		/* Non-fatal: shell + mode transitions still work; only
		 * the visual LED indicators and the P3.1 scope trigger
		 * are dark. */
	}

	pm_init();

	printf("CM33-S: initial power mode %s\n",
	       pm_mode_name(pm_current_mode()));
	return 0;
}
```

## src/cmd_deep_sleep.c
```c
/*
 * Copyright (c) 2026
 * SPDX-License-Identifier: Apache-2.0
 */

/**
 * @file
 * @brief `deep_sleep` shell command -- put CM33 into CPU Deep Sleep
 *        until the next NVIC IRQ (typically a LPTIMER tick).
 *
 * Relationship to `sleep`:
 *
 *   sleep       Cy_SysPm_CpuEnterSleep       -- just WFI. CPU pipeline
 *                                               halts, all clocks and
 *                                               peripherals stay alive.
 *                                               Buck at active voltage.
 *
 *   deep_sleep  Cy_SysPm_CpuEnterDeepSleep   -- SLEEPDEEP bit set, then
 *                                               WFI. Enables buck to drop
 *                                               to 0.70V LP topology, HF
 *                                               clocks to gate, IHO/IMO
 *                                               to stop, BGREF to go LP.
 *                                               Deepest state before
 *                                               DS-RAM / DS-OFF.
 *
 * Per AN237976 the SoC auto-escalates to *System* Deep Sleep when both
 * CPUs are in Deep Sleep AND the PPUs match Table 2. Our project 06
 * has already collapsed the APP-domain PPUs (PD1/APPCPU/APPCPUSS/
 * SOCMEM/U55 all OFF) via pm_boot_optimize, and CM55 never boots, so
 * the SoC sees "all CPUs asleep" as soon as CM33 executes WFI here.
 * The SYS-domain PPUs (MAIN, SRAM0/1, SYSCPU) are left at their
 * boot-time ON state, which is a valid target for both plain Deep
 * Sleep and DS-RAM per Table 2.
 *
 * Wake source: MCWDT0/LPTIMER on PILO, alive across Deep Sleep by
 * design (PILO is a deep-sleep-alive clock). k_msleep(20) at the top
 * of the handler schedules the next Zephyr deadline, and that is
 * what wakes us -- the LPTIMER driver's ISR fires the tick, Cortex-M
 * wakes on the NVIC pending edge. UART RX does NOT wake System Deep
 * Sleep (only SCB0 supports DS wake; our shell UART is on SCB2).
 *
 * Layer-B static prep (SYS_INIT at PRE_KERNEL_2) mirrors the
 * reference tmp/16_pse84_3img_rram_pm/m33_ns/src/power.c
 * ifx_pm_init:
 *
 *   1. BGREF into low-power mode -- lower bandgap reference current
 *      during Deep Sleep.
 *   2. Core buck DS-target: 0.70 V, LP topology, override enabled --
 *      when SLEEPDEEP is asserted the buck reconfigures to this.
 *   3. Stop IHO during Deep Sleep (Cy_SysClk_IhoDeepsleepDisable).
 *      IHO is a 50 MHz internal high-frequency oscillator that feeds
 *      DPLL_LP0 in this project; keeping it running in DS wastes
 *      current since HF clocks are all gated anyway.
 *   4. Stop IMO during Deep Sleep (SRSS_CLK_IMO_CONFIG bit clear).
 *   5. CLK_BAK <- PILO so backup domain (RTC, BREGs) stays clocked.
 *   6. Vote plain DEEPSLEEP (not DS-RAM/OFF) as the System
 *      deep-sleep mode.
 *
 * Layer-A per-entry sequence (cmd_deep_sleep):
 *
 *   1. pm-busy HIGH, banner print, k_msleep(20) TX drain.
 *   2. pm-busy LOW -- WFI window starts.
 *   3. PRIMASK on, BASEPRI off, __DSB.
 *   4. Cy_SysPm_CpuEnterDeepSleep(WAIT_FOR_INTERRUPT) -- sets
 *      SLEEPDEEP, executes WFI.
 *   5. On wake, clear SLEEPDEEP so that any subsequent Zephyr idle
 *      WFI is plain CPU sleep (not another deep sleep from the same
 *      thread).
 *   6. __enable_irq, pm-busy HIGH, print dwell, pm-busy LOW.
 */

#include <zephyr/init.h>
#include <zephyr/kernel.h>
#include <zephyr/shell/shell.h>
#include <zephyr/sys/time_units.h>

#include <cmsis_core.h>
#include <cy_pdl.h>
#include <cy_sysclk.h>
#include <cy_syspm.h>
#include <soc.h>

#include <stddef.h>

#include "gpio_indicators.h"

/* ------------------------------------------------------------------
 * Layer-B: one-shot static prep at PRE_KERNEL_2 (before main())
 * ------------------------------------------------------------------ */

/**
 * @brief Put SRSS bandgap reference into low-power mode.
 *
 * BGREF_LPMODE bit trades a small startup-time penalty (irrelevant
 * for our use case -- we wake on LPTIMER tick, not on a sharp
 * transient) for a few tens of µA saved during Deep Sleep.
 */
static void deep_sleep_bgref_lp(void)
{
	SRSS_PWR_CTL2 |= SRSS_PWR_CTL2_BGREF_LPMODE_Msk;
}

/**
 * @brief Configure core buck to drop to 0.70 V / LP topology when
 *        SLEEPDEEP is asserted.
 *
 * Buck has two configurations: "active" (drives HP/LP/ULP mode
 * voltage, high-power low-ripple topology, up to 400 mA load) and
 * "deep-sleep" (this override -- low-power high-ripple topology
 * targeting ~0.70 V for retention loads only).
 *
 * The override bit tells the PMU to switch to the DS config
 * automatically when SLEEPDEEP is set in SCB_SCR. On wake, the PMU
 * switches back to the active config before releasing SLEEPDEEP.
 */
static void deep_sleep_buck_config(void)
{
	Cy_SysPm_CoreBuckDpslpSetVoltage(CY_SYSPM_CORE_BUCK_VOLTAGE_0_70V);
	Cy_SysPm_CoreBuckDpslpSetMode(CY_SYSPM_CORE_BUCK_MODE_LP);
	Cy_SysPm_CoreBuckDpslpEnableOverride(true);
}

/**
 * @brief Stop the internal high-frequency oscillators in Deep Sleep.
 *
 *   IHO -- 50 MHz internal HF oscillator. Feeds DPLL_LP0 (which
 *          feeds HF0 = CM33 core clock). In Deep Sleep HF clocks are
 *          gated, so IHO has no consumers; disabling saves a few
 *          hundred µA on its bias current.
 *
 *   IMO -- 8 MHz internal medium-frequency oscillator. Not used as
 *          a source anywhere in this project (already off in
 *          previous ClkPath configs); the DPSLP_ENABLE bit is
 *          cleared here for completeness.
 *
 * PILO is deliberately NOT touched: it clocks MCWDT0 which is our
 * Zephyr system timer AND the only viable wake source for Deep
 * Sleep. Disabling PILO would make the CPU un-wakeable.
 */
static void deep_sleep_stop_osc(void)
{
	Cy_SysClk_IhoDeepsleepDisable();
	SRSS_CLK_IMO_CONFIG &= ~SRSS_CLK_IMO_CONFIG_DPSLP_ENABLE_Msk;
}

/**
 * @brief Point CLK_BAK at PILO so backup-domain peripherals (RTC,
 *        BREGs) keep ticking through Deep Sleep.
 */
static void deep_sleep_backup_clock(void)
{
	Cy_SysClk_ClkBakSetSource(CY_SYSCLK_BAK_IN_PILO);
}

/**
 * @brief One-shot boot hook. Runs at PRE_KERNEL_2, after
 *        pm_early_mcwdt_reset (PRE_KERNEL_1) and before the shell
 *        thread starts.
 *
 * Sets up the SRSS + PMU + buck + clock knobs so that a subsequent
 * `deep_sleep` shell command achieves its full current-drop
 * potential. Cy_SysPm_SetDeepSleepMode votes plain DEEPSLEEP (not
 * DS-RAM or DS-OFF), matching what CpuEnterDeepSleep does on
 * SLEEPDEEP entry.
 */
static int pm_deep_sleep_init(void)
{
	Cy_SysPm_Init();
	deep_sleep_bgref_lp();
	deep_sleep_buck_config();
	deep_sleep_stop_osc();
	deep_sleep_backup_clock();
	(void)Cy_SysPm_SetDeepSleepMode(CY_SYSPM_MODE_DEEPSLEEP);
	return 0;
}

SYS_INIT(pm_deep_sleep_init, PRE_KERNEL_2,
	 CONFIG_KERNEL_INIT_PRIORITY_DEFAULT);

/* ------------------------------------------------------------------
 * Layer-A: shell handler
 * ------------------------------------------------------------------ */

/**
 * @brief Shell handler for `deep_sleep`.
 *
 * Semantics identical to @c cmd_sleep except the entry API is
 * @c Cy_SysPm_CpuEnterDeepSleep (SLEEPDEEP asserted before WFI)
 * and SLEEPDEEP is cleared on wake to keep Zephyr's idle-thread
 * WFI as plain CPU sleep afterwards.
 */
static int cmd_deep_sleep(const struct shell *sh, size_t argc, char **argv)
{
	ARG_UNUSED(argc);
	ARG_UNUSED(argv);

	gpio_indicators_transition_begin();

	shell_print(sh, "entering CPU deep sleep -- wakes on LPTIMER tick");

	/* Let the shell TX ring drain before WFI. With mcwdt0 now the
	 * Zephyr system timer, k_msleep(20) really waits 20 ms at
	 * every HP/LP/ULP mode -- comfortable margin for ~60 chars at
	 * 115200 baud (~5 ms actual drain). */
	k_msleep(20);

	gpio_indicators_transition_end();

	uint32_t t_enter = k_cycle_get_32();

	/* PRIMASK on, BASEPRI off -- see cmd_sleep.c file-comment.
	 * The Deep Sleep SLEEPDEEP bit is set by CpuEnterDeepSleep;
	 * we clear it on wake so subsequent Zephyr idle-WFIs from the
	 * same context don't unintentionally deep-sleep. */
	__disable_irq();
	irq_unlock(0);
	__DSB();
	(void)Cy_SysPm_CpuEnterDeepSleep(CY_SYSPM_WAIT_FOR_INTERRUPT);
	SCB_SCR &= (uint32_t)~SCB_SCR_SLEEPDEEP_Msk;
	__enable_irq();

	uint32_t t_exit = k_cycle_get_32();

	gpio_indicators_transition_begin();

	uint32_t dwell_cyc = t_exit - t_enter;
	uint32_t dwell_us = k_cyc_to_us_floor32(dwell_cyc);

	shell_print(sh, "woke after %u us (%u LPTIMER cycles @ 32768 Hz)",
		    dwell_us, dwell_cyc);

	gpio_indicators_transition_end();
	return 0;
}

SHELL_CMD_REGISTER(deep_sleep, NULL,
		   "Enter CPU Deep Sleep (SLEEPDEEP + WFI) until any NVIC IRQ "
		   "(LPTIMER tick). Pair with `noidle on` to see the "
		   "active-vs-deep-sleep current delta.",
		   cmd_deep_sleep);
```

## src/cmd_noidle.c
```c
/*
 * Copyright (c) 2026
 * SPDX-License-Identifier: Apache-2.0
 */

/**
 * @file
 * @brief `noidle` shell command + Zephyr idle-hook to suppress WFI.
 *
 * Motivation: on this build the Zephyr idle thread runs
 * @c arch_cpu_idle() which normally does @c __WFI(). That means
 * "shell prompt idle" current on the PPK2 is already CPU-sleep
 * current -- WFI is happening whenever no thread has work.
 *
 * For a DVFS demo we sometimes want to see the OPPOSITE: what
 * does the SoC pull when the CM33 is genuinely executing code
 * (fetching, decoding, executing) at 200 / 80 / 50 MHz? That is
 * the delta the "sleep" command will reclaim, and without a way
 * to force the CPU into that state on demand there is nothing to
 * compare against.
 *
 * Zephyr exposes exactly this knob via @c CONFIG_ARM_ON_ENTER_CPU_IDLE_HOOK.
 * When enabled, the arch layer calls @c z_arm_on_enter_cpu_idle()
 * right before it would execute WFI. Returning @c false skips
 * WFI entirely -- the idle thread then just spin-loops through
 * @c arch_cpu_idle() returning immediately, and higher-priority
 * threads (or ISRs) still preempt as usual.
 *
 * Shell interface:
 *
 *   noidle          -- print current state ("on" or "off")
 *   noidle on       -- suppress WFI in idle. CPU runs continuously
 *                      at the current HP/LP/ULP mode clock rate.
 *                      PPK2 shows the real active current for
 *                      that mode.
 *   noidle off      -- restore normal WFI in idle. This is the
 *                      default state at boot. PPK2 shows the
 *                      sleep floor plus whatever the workqueue /
 *                      housekeeping wakes cost.
 *
 * Nothing else in this project queries the flag -- the hook is
 * the only consumer. Made @c atomic_t so a stray future concurrent
 * writer is well-defined; the hook itself runs from the idle
 * thread and cannot be preempted by another writer today.
 */

#include <zephyr/init.h>
#include <zephyr/kernel.h>
#include <zephyr/shell/shell.h>
#include <zephyr/sys/atomic.h>

#include <stddef.h>

/**
 * @brief When non-zero, @c z_arm_on_enter_cpu_idle returns false
 *        and the idle thread's WFI is skipped.
 */
static atomic_t s_prevent_idle;

/**
 * @brief ARM idle-entry hook (enabled by CONFIG_ARM_ON_ENTER_CPU_IDLE_HOOK).
 *
 * Called from @c arch_cpu_idle() with interrupts already disabled
 * via PRIMASK and BASEPRI set to 0. Return @c true to let the WFI
 * run (default), @c false to bypass it and return immediately.
 *
 * Keeping the check as a single atomic-read means no lock, no
 * branch predictor surprise, and the hook itself costs a handful
 * of cycles per idle entry -- negligible next to the WFI it
 * gates.
 */
bool z_arm_on_enter_cpu_idle(void) { return atomic_get(&s_prevent_idle) == 0; }

/**
 * @brief Shell handler for `noidle [on|off]`.
 *
 * With no argument, reports the current state. With "on" or
 * "off", sets it. Any other argument is a syntax error.
 */
static int cmd_noidle(const struct shell *sh, size_t argc, char **argv)
{
	if (argc == 1) {
		shell_print(sh, "noidle is %s",
			    (atomic_get(&s_prevent_idle) != 0) ? "on" : "off");
		return 0;
	}

	if (argc != 2) {
		shell_error(sh, "usage: noidle [on|off]");
		return -EINVAL;
	}

	if (strcmp(argv[1], "on") == 0) {
		atomic_set(&s_prevent_idle, 1);
		shell_print(sh, "noidle on -- CPU spins in idle (no WFI)");
		return 0;
	}
	if (strcmp(argv[1], "off") == 0) {
		atomic_set(&s_prevent_idle, 0);
		shell_print(sh, "noidle off -- WFI in idle (default)");
		return 0;
	}

	shell_error(sh, "usage: noidle [on|off]");
	return -EINVAL;
}

SHELL_CMD_REGISTER(noidle, NULL,
		   "Suppress WFI in idle thread. Use `noidle on` to see real "
		   "active current at the current HP/LP/ULP mode.",
		   cmd_noidle);
```

## src/cmd_sleep.c
```c
/*
 * Copyright (c) 2026
 * SPDX-License-Identifier: Apache-2.0
 */

/**
 * @file
 * @brief `sleep` shell command -- put CM33 into CPU-sleep (WFI) until
 *        the next NVIC IRQ (typically a UART RX character).
 *
 * Motivation: with `noidle on` the CPU spin-loops in idle and pulls
 * the mode's real active current (HP 5.36 / LP 2.34 / ULP 1.54 mA
 * measured). Running an explicit `sleep` puts the core into WFI on
 * demand and drops the current back to the sleep floor (HP 3.34 /
 * LP 1.73 / ULP 1.16 mA measured) until a keypress. Together with
 * `noidle`, the pair gives an on-demand active-vs-sleep A/B
 * measurement without waiting for Zephyr's idle thread to decide.
 *
 * Cycle instrumentation: reads @c k_cycle_get_32 (which on this SoC
 * is @c Cy_MCWDT_GetCountCascaded (counter2 @ 50 MHz LPTIMER)) both
 * sides of the @c __WFI. The delta is wall-clock time -- the CPU
 * pipeline was stopped, but the LPTIMER runs off HF10 (independent
 * of HF0). This is the number PPK2's D7 sees as the sleep window
 * width.
 *
 * pm-busy GPIO framing so external post-processing (PPK2 + D7 line)
 * can locate the WFI window automatically:
 *
 *   pm-busy HIGH       cmd running (banner print + TX drain, ~20 ms)
 *   pm-busy LOW        WFI window (variable duration -- user waits,
 *                                  presses key, chip wakes)
 *   pm-busy HIGH       post-wake (elapsed print, ~1 ms)
 *   pm-busy LOW        back to shell prompt
 *
 * IRQ prologue mirrors tmp/16_pse84_3img_rram_pm/m33_ns/src/power.c:
 * PRIMASK on, BASEPRI off, so the CPU still wakes on any enabled
 * NVIC source but interrupts don't actually take (they just pend
 * and get serviced after __enable_irq). Without this, WFI can
 * either miss the wake (BASEPRI masks the source out) or run the
 * ISR mid-instrumentation (jitters the cycle count).
 *
 * Break-even relative to `noidle on`:
 *   The entry/exit overhead is dominated by shell_print + k_msleep
 *   (tens of ms) which is a demo-only cost. The interesting number
 *   is the WFI entry/exit itself: on Cortex-M33 that is a handful
 *   of CPU cycles either side of the instruction (order 10 ns at
 *   200 MHz). At any HP/LP/ULP active-vs-sleep delta above ~0.4 mA,
 *   break-even is under 1 us. That is: any sleep window longer than
 *   ~1 us is a net energy win. Post-processing table quantifies
 *   this per mode.
 */

#include <zephyr/kernel.h>
#include <zephyr/shell/shell.h>
#include <zephyr/sys/time_units.h>

#include <cmsis_core.h>
#include <cy_sysclk.h>

#include <stddef.h>

#include "gpio_indicators.h"

/**
 * @brief Shell handler for `sleep`.
 *
 * Blocks the shell thread on WFI until the next NVIC interrupt.
 * The chip's UART RX IRQ is enabled and unmasked, so any character
 * typed in the terminal wakes the CPU. Other enabled ISRs
 * (LPTIMER, workqueue) may also wake spuriously; the printed
 * duration lets the user distinguish "keypress wake" (100+ ms) from
 * "housekeeping wake" (~80 ms periodic on this build).
 */
static int cmd_sleep(const struct shell *sh, size_t argc, char **argv)
{
	ARG_UNUSED(argc);
	ARG_UNUSED(argv);

	/* Mark: sleep command is running (pm-busy HIGH). */
	gpio_indicators_transition_begin();

	shell_print(sh, "entering CPU sleep -- press any key to wake");

	/* Let the shell TX ring drain before WFI. In IRQ-driven mode
	 * the TX-empty IRQ would spuriously wake us mid-drain; a
	 * short sleep here yields to that IRQ path via the idle
	 * thread (which itself still WFIs -- noidle only affects
	 * arch_cpu_idle, not k_sleep) and returns once the shell TX
	 * is quiescent. 20 ms is enough for ~200 chars at 115200 8N1. */
	k_msleep(20);

	/* Mark: about to WFI (pm-busy HIGH -> LOW). Post-processing
	 * uses this falling edge as the sleep-window start. */
	gpio_indicators_transition_end();

	uint32_t t_enter = k_cycle_get_32();

	/* PRIMASK on, BASEPRI off -- see file-level comment. */
	__disable_irq();
	irq_unlock(0);
	__DSB();
	__WFI();
	__enable_irq();

	uint32_t t_exit = k_cycle_get_32();

	/* Mark: woke up (pm-busy LOW -> HIGH). Post-processing uses
	 * this rising edge as the sleep-window end. */
	gpio_indicators_transition_begin();

	uint32_t dwell_cyc = t_exit - t_enter;

	/* k_cycle_get_32 reads the Zephyr system-clock counter. Since
	 * mcwdt0 was enabled and CONFIG_CORTEX_M_SYSTICK turned off,
	 * that counter is now the LPTIMER (MCWDT0 on PILO at 32.768
	 * kHz) -- constant across HP/LP/ULP modes, unlike SysTick
	 * which was clocked from HF0. k_cyc_to_us_floor32 uses the
	 * matching CONFIG_SYS_CLOCK_HW_CYCLES_PER_SEC (=32768) so it
	 * is now the right conversion. */
	uint32_t dwell_us = k_cyc_to_us_floor32(dwell_cyc);

	shell_print(sh, "woke after %u us (%u LPTIMER cycles @ 32768 Hz)",
		    dwell_us, dwell_cyc);

	/* Mark: shell prompt returning (pm-busy HIGH -> LOW). */
	gpio_indicators_transition_end();
	return 0;
}

SHELL_CMD_REGISTER(sleep, NULL,
		   "Enter CPU sleep (WFI) until any NVIC IRQ (e.g. UART RX). "
		   "Prints wall-clock dwell on wake. Pair with `noidle on` "
		   "to see the active-vs-sleep current delta.",
		   cmd_sleep);
```

## src/gpio_indicators.h
```c
/*
 * Copyright (c) 2026
 * SPDX-License-Identifier: Apache-2.0
 */

/**
 * @file
 * @brief GPIO indicators for the HP/LP/ULP demo -- mode-indicator
 *        LEDs and a scope-trigger "PM busy" signal.
 *
 * Owns two kinds of outputs:
 *
 *   - Two mode-indicator LEDs (led0 red, led1 green). The current
 *     power mode is shown by lighting one, both, or neither. Blue
 *     (led2) is deliberately not owned here -- it belongs to the
 *     diagnostic heartbeat thread in @c src/diag.c.
 *
 *   - One PM-busy scope trigger on pin P3.1 (device-tree alias
 *     `pm-busy`). Driven high by the shell command layer while a
 *     mode transition is in progress and low again once the
 *     transition (including SCB retune + clock probe) has
 *     completed. Wire a scope or logic-analyzer probe here to
 *     correlate current-draw waveforms with the software
 *     transition window.
 */

#ifndef APP_GPIO_INDICATORS_H_
#define APP_GPIO_INDICATORS_H_

#ifdef __cplusplus
extern "C" {
#endif

/**
 * @brief Configure the indicator LEDs and the pm-busy signal as
 *        outputs in the inactive state.
 *
 * Must be called once at bring-up before any of the other
 * @c gpio_indicators_* functions.
 *
 * @return 0 on success, negative errno if any GPIO is not ready or
 *         cannot be configured. Failure leaves the application
 *         usable but the visual / scope indicators dark.
 */
int gpio_indicators_init(void);

/**
 * @brief Drive the two mode-indicator LEDs to match the incoming
 *        power mode. Blue LED (led2) is left alone.
 *
 * @param red    Non-zero to light red, zero to turn it off.
 * @param green  Non-zero to light green, zero to turn it off.
 */
void gpio_indicators_set_mode_leds(int red, int green);

/**
 * @brief Assert the PM-busy scope trigger (drive P3.1 high) to mark
 *        the start of a mode transition.
 *
 * Idempotent -- safe to call twice in a row, the pin just stays
 * high. Pair with @ref gpio_indicators_transition_end.
 */
void gpio_indicators_transition_begin(void);

/**
 * @brief De-assert the PM-busy scope trigger (drive P3.1 low) to
 *        mark the end of a mode transition.
 *
 * Idempotent. Pair with @ref gpio_indicators_transition_begin.
 */
void gpio_indicators_transition_end(void);

#ifdef __cplusplus
}
#endif

#endif /* APP_GPIO_INDICATORS_H_ */
```

## src/pm_early_boot.c
```c
/*
 * Copyright (c) 2026
 * SPDX-License-Identifier: Apache-2.0
 */

/**
 * @file
 * @brief Early boot hook -- disable MCWDT0 counters so the Zephyr
 *        LPTIMER driver's init succeeds.
 *
 * Corresponds to pm_early_mcwdt_reset() in project 06's
 * pm_boot_optimize.c. The other 06 boot-time trims (SOCMEM off,
 * SMIF0/1 off, PD1 / APPCPU / APPCPUSS / SOCMEM / U55 PPUs off,
 * HF1..HF9/11..13 gated, DPLLs disabled) are deliberately NOT
 * ported to this project: they would kill CM55 (which lives in PD1,
 * fetches its XIP from SMIF0, and needs APPCPUSS/APPCPU alive).
 *
 * Only the MCWDT reset is kept because it is orthogonal to CM55 and
 * is required for the LPTIMER PDL driver -- without it the driver's
 * Cy_MCWDT_Init returns BAD_PARAM (counters already enabled by SE-ROM),
 * lptimer_init returns -EINVAL, sys_clock never starts, and every
 * subsequent k_msleep/k_busy_wait hangs forever.
 */

#include <zephyr/init.h>

/* soc.h pulls in infineon_kconfig.h which defines COMPONENT_SECURE_DEVICE.
 * Must come before <cy_pdl.h> so cy_device_headers.h selects the secure
 * device variant (pse846gps2dbzc4a_s.h) and cy_pdl_srf.h's unconditional
 * #include "mtb_srf_pool.h" is guarded out for this secure-only build. */
#include <soc.h>
#include <cy_pdl.h>

static int pm_early_mcwdt_reset(void)
{
	Cy_MCWDT_Unlock(MCWDT_STRUCT0);
	Cy_MCWDT_Disable(MCWDT_STRUCT0,
			 CY_MCWDT_CTR0 | CY_MCWDT_CTR1 | CY_MCWDT_CTR2, 100U);
	Cy_MCWDT_ClearInterrupt(MCWDT_STRUCT0,
				CY_MCWDT_CTR0 | CY_MCWDT_CTR1 | CY_MCWDT_CTR2);
	Cy_MCWDT_SetInterruptMask(MCWDT_STRUCT0, 0U);
	return 0;
}

SYS_INIT(pm_early_mcwdt_reset, PRE_KERNEL_1, 0);
```

## src/pm_phase_log.c
```c
/*
 * Copyright (c) 2026
 * SPDX-License-Identifier: Apache-2.0
 */

/**
 * @file
 * @brief Implementation of the per-transition phase log.
 * See @c pm_phase_log.h for the interface contract.
 */

#include "pm_phase_log.h"

#include <stdint.h>

#include <zephyr/sys/printk.h>

/* Sized for the strategy with the most phases -- currently PLL_RETUNE
 * and HF0_DIVIDER both use three (pll_pre/volt/pll_post and
 * div/enter/rram respectively). Bump if a future strategy needs
 * finer granularity. */
#define PM_PHASE_LOG_MAX_PHASES 8

static uint32_t s_cycles[PM_PHASE_LOG_MAX_PHASES];
static const char *s_names[PM_PHASE_LOG_MAX_PHASES];
static uint8_t s_count;
static const char *s_label = "";

void pm_phase_log_reset(const char *label)
{
	s_label = (label != NULL) ? label : "";
	s_count = 0u;
}

void pm_phase_log_record(const char *name, uint32_t cycles)
{
	if (s_count < PM_PHASE_LOG_MAX_PHASES) {
		s_names[s_count] = (name != NULL) ? name : "?";
		s_cycles[s_count] = cycles;
		s_count++;
	}
}

void pm_phase_log_print(void)
{
	uint32_t total = 0u;
	uint8_t i;

	if (s_count == 0u) {
		return;
	}
	printk("[pm] %s phase cycles:", s_label);
	for (i = 0u; i < s_count; i++) {
		total += s_cycles[i];
		printk(" %s=%u", s_names[i], s_cycles[i]);
	}
	printk(" total=%u\n", total);
}

uint32_t pm_phase_log_total_cycles(void)
{
	uint32_t total = 0u;
	uint8_t i;

	for (i = 0u; i < s_count; i++) {
		total += s_cycles[i];
	}
	return total;
}
```

## src/power_manager.c
```c
/*
 * Copyright (c) 2026
 * SPDX-License-Identifier: Apache-2.0
 */

/**
 * @file
 * @brief HP / LP / ULP switcher for PSE84 CM33-Secure -- orchestration.
 *
 * Public API is in @c power_manager.h. The DVFS mechanics live in
 * one of two sibling files, selected at compile time:
 *
 *   PM_STRATEGY_PLL_RETUNE   -> power_manager_pll_retune.c
 *   PM_STRATEGY_HF0_DIVIDER  -> power_manager_hf0_divider.c
 *
 * Both provide the @c pm_strategy_* symbols declared in
 * @c power_manager_internal.h; only one is linked per build.
 * See @c PLAN_dual_dvfs.md for the strategy trade-offs and
 * @c PLAN_pm_refactor.md for the module split.
 *
 * This file owns the shared state (current mode, console UART
 * handle), the raw-SCB @c TRACE macro, the @c pm_syspm_enter
 * voltage-step primitive, the hardware clock-measurement probe,
 * and the four public entry points -- each a thin wrapper that
 * delegates the strategy-specific decision to @c pm_strategy_*.
 */

#include "power_manager.h"

#include <errno.h>

#include <zephyr/device.h>
#include <zephyr/drivers/uart.h>
#include <zephyr/kernel.h>
#include <zephyr/sys/printk.h>

#include "cy_pdl.h"

#include "diag.h"
#include "gpio_indicators.h"
#include "pm_phase_log.h"
#include "power_manager_internal.h"

/* ==================================================================
 * Shared state and helpers.
 * ================================================================== */

/** Current active power mode; boot state is HP. */
static pm_mode_t s_current_mode = PM_MODE_HP;

/** Console UART handle. The SCB baud divider it caches at boot is
 *  only valid for the CLK_HF10 in effect at that time. */
static const struct device *const console_uart =
    DEVICE_DT_GET(DT_CHOSEN(zephyr_console));

/**
 * @brief Re-run @c uart_configure() so the Infineon SCB driver
 *        recomputes its baud divider against the currently-live
 *        @c CLK_HF10. No-op if the device is not ready.
 */
static void pm_reconfigure_console_uart(void)
{
	struct uart_config cfg;

	if (!device_is_ready(console_uart)) {
		return;
	}
	if (uart_config_get(console_uart, &cfg) != 0) {
		return;
	}
	(void)uart_configure(console_uart, &cfg);
}

/**
 * Raw-SCB2 step markers. Bypass the Zephyr UART driver so a hang
 * mid-transition still leaves the last-known step on the wire.
 * See @c src/diag.h for the alive/dead diagnosis matrix.
 */
#define TRACE(msg) diag_trace("<T:" msg ">\n")

cy_en_syspm_status_t pm_syspm_enter(pm_mode_t target)
{
	switch (target) {
	case PM_MODE_HP:
		TRACE("switch:EnterHp");
		return Cy_SysPm_SystemEnterHp();
	case PM_MODE_LP:
		TRACE("switch:EnterLp");
		return Cy_SysPm_SystemEnterLp();
	case PM_MODE_ULP:
		TRACE("switch:EnterUlp");
		return Cy_SysPm_SystemEnterUlp();
	default:
		return CY_SYSPM_FAIL;
	}
}

/* ==================================================================
 * Public API.
 * ================================================================== */

const char *pm_mode_name(pm_mode_t m) { return pm_strategy_mode_name(m); }

pm_mode_t pm_current_mode(void) { return s_current_mode; }

void pm_init(void)
{
	/* The DT overlay lands the SoC in an in-spec HP state at boot
	 * (DPLL_LP0 200 MHz, CLK_HF0 /1, CM33 at the AN237976 HP
	 * ceiling). Nothing to reprogram here -- the strategy's own
	 * init hook does whatever it needs (register SysPm callbacks
	 * for PLL_RETUNE, nothing for HF0_DIVIDER). */
	s_current_mode = PM_MODE_HP;
	pm_strategy_init();
	SystemCoreClockUpdate();
}

int pm_switch_to(pm_mode_t target)
{
	int rc;
	pm_mode_t source;
	uint32_t t_start, t_end, cycles;

	if (target == s_current_mode) {
		return 0;
	}
	if (target != PM_MODE_HP && target != PM_MODE_LP &&
	    target != PM_MODE_ULP) {
		return -EINVAL;
	}

	source = s_current_mode;

	/* P3.1 (pm-busy) is asserted around ONLY the strategy call so
	 * an external instrument (PPK2 D7, scope on P3.1) captures the
	 * DVFS transient itself and nothing else -- no shell prints,
	 * no UART retune, no clock probe. That GPIO pulse width is the
	 * authoritative transition wall time.
	 *
	 * The cycle counters below record CPU work only. They cannot
	 * be trusted as absolute wall time because CLK_HF0 (which
	 * SysTick is sourced from) changes several times inside a
	 * transition -- source rate at entry, IHO bypass while the
	 * PLL is disabled, intermediate rate while the PLL is locked
	 * to it, target rate at exit. Cross-reference these counts
	 * with the PPK2 pulse width via scripts/postprocess.py. */
	t_start = k_cycle_get_32();
	gpio_indicators_transition_begin();
	rc = pm_strategy_transition(source, target);
	gpio_indicators_transition_end();
	t_end = k_cycle_get_32();

	if (rc != 0) {
		TRACE("switch:FAIL");
		return rc;
	}

	s_current_mode = target;
	SystemCoreClockUpdate();

	if (pm_strategy_needs_uart_retune()) {
		/* CLK_HF10 changed -> SCB baud divider is stale. Retune
		 * runs here (IRQs re-enabled after Cy_SysPm_SystemEnter*
		 * returned); the same call inside the SysPm critical
		 * section is empirically unsafe on this driver. */
		diag_trace_flush();
		pm_reconfigure_console_uart();
	}

	cycles = t_end - t_start;
	printk("[pm] transition %s -> %s : %u cycles\n", pm_mode_name(source),
	       pm_mode_name(target), cycles);
	pm_strategy_print_last_phases();

	TRACE("switch:complete");
	pm_clock_probe();
	return 0;
}

/* ==================================================================
 * Hardware clock probe.
 *
 * The SoC has dedicated 24-bit counters that measure any clock
 * against a fixed reference (IHO, 50 MHz, always running). We also
 * print the PDL's computed frequencies alongside so a broken
 * counter is immediately visible.
 * ================================================================== */

#define PM_PROBE_REF_COUNT 50000u /* 1 ms wall time at IHO 50 MHz */
#define PM_MEAS_SAFETY_ITERS                                                   \
	1000000u /* >>100x headroom over the 1 ms window                       \
		  */

static uint32_t pm_measure_hz(cy_en_meas_clks_t measured)
{
	cy_en_sysclk_status_t st;
	uint32_t safety;

	st = Cy_SysClk_StartClkMeasurementCounters(
	    CY_SYSCLK_MEAS_CLK_IHO, PM_PROBE_REF_COUNT, measured);
	if (st != CY_SYSCLK_SUCCESS) {
		return 0u;
	}
	safety = PM_MEAS_SAFETY_ITERS;
	while (!Cy_SysClk_ClkMeasurementCountersDone() && (--safety != 0u)) {
		/* spin */
	}
	if (safety == 0u) {
		return 0u;
	}
	return Cy_SysClk_ClkMeasurementCountersGetFreq(true,
						       CY_SYSCLK_IHO_FREQ);
}

static void pm_print_hz(const char *label, uint32_t meas_hz, uint32_t comp_hz)
{
	printk(
	    "[clk] %s meas=%3u.%03u MHz (%9u Hz)  comp=%3u.%03u MHz (%9u Hz)\n",
	    label, meas_hz / 1000000u, (meas_hz / 1000u) % 1000u, meas_hz,
	    comp_hz / 1000000u, (comp_hz / 1000u) % 1000u, comp_hz);
}

void pm_clock_probe(void)
{
	uint32_t m_path0 = pm_measure_hz(CY_SYSCLK_MEAS_CLK_PATH0);
	uint32_t m_hf0 = pm_measure_hz(CY_SYSCLK_MEAS_CLK_CLKHF0);
	uint32_t m_hf10 = pm_measure_hz(CY_SYSCLK_MEAS_CLK_CLKHF10);

	uint32_t c_path0 = Cy_SysClk_ClkPathGetFrequency(0u);
	uint32_t c_hf0 = Cy_SysClk_ClkHfGetFrequency(0u);
	uint32_t c_hf10 = Cy_SysClk_ClkHfGetFrequency(10u);

	pm_print_hz("DPLL_LP0 ", m_path0, c_path0);
	pm_print_hz("CLK_HF0  ", m_hf0, c_hf0);	  /* CM33 core   */
	pm_print_hz("CLK_HF10 ", m_hf10, c_hf10); /* SCB2 peri   */

	pm_strategy_probe_status();
}
```

## src/power_manager_hf0_divider.c
```c
/*
 * Copyright (c) 2026
 * SPDX-License-Identifier: Apache-2.0
 */

/**
 * @file
 * @brief DVFS strategy: keep DPLL_LP0 at 200 MHz, change only the
 *        CLK_HF0 divider per mode. Selected by
 *        @c PM_STRATEGY_HF0_DIVIDER.
 *
 * Six direction-aware helpers wrap @c Cy_SysClk_ClkHfSetDivider(0,.),
 * the voltage step (@c pm_syspm_enter) and @c Cy_RRAM_SetVoltageMode.
 * DPLL_LP0 is never touched, so @c CLK_HF10 (SCB2 pclk) stays at
 * 50 MHz in every mode and the console baud divider never needs
 * retuning.
 *
 * Trade-off vs. the PLL-retune strategy: LP lands at 66 MHz
 * (200 / 3, closest integer divider) instead of the 80 MHz LP spec
 * ceiling, and peripheral clocks do not scale down. Transition
 * wall time drops from ~450 ms to ~1-5 ms.
 *
 * Direction rule (from AN237976 + the Infineon switch_power_modes
 * reference):
 *   Down (voltage falls): drop the ClkHf0 divider FIRST, then
 *                         Cy_SysPm_SystemEnter*, then RRAM VMODE.
 *   Up   (voltage rises): Cy_SysPm_SystemEnter* FIRST, then RRAM
 *                         VMODE, then remove the ClkHf0 divider.
 *
 * See @c PLAN_dual_dvfs.md for the design rationale.
 */

#include "power_manager_internal.h"

#ifdef PM_STRATEGY_HF0_DIVIDER

#include <errno.h>

#include <zephyr/kernel.h>
#include <zephyr/sys/printk.h>

#include "cy_pdl.h"

#include "pm_phase_log.h"

/* ------------------------------------------------------------------
 * Per-phase timing capture.
 *
 * Each trans_ helper below records a k_cycle_get_32() timestamp
 * between each PDL call and pushes the three cycle-delta values
 * into the shared pm_phase_log module. After the strategy returns
 * to pm_switch_to(), pm_strategy_print_last_phases() forwards to
 * pm_phase_log_print() which emits e.g.:
 *   [pm] hp2ulp phase cycles: div=200 enter=140000 rram=250 total=140450
 *
 * Raw cycle counts only -- no us conversion here. The CPU clock
 * changes across a transition and no single divisor is right for
 * the whole span, so wall-time authority lives with external
 * instrumentation (PPK2 D7 pulse, scope on P3.1). See
 * scripts/postprocess.py for the cross-reference.
 * ------------------------------------------------------------------ */

/* ------------------------------------------------------------------
 * Six direction-aware transition helpers.
 * Each returns 0 on success, -EIO on PDL failure.
 * Each records "div", "enter", "rram" phase deltas in the order
 * the strategy runs them (order differs between down- and
 * up-direction transitions -- see per-helper comments).
 * ------------------------------------------------------------------ */

/** HP -> LP (down): /3, EnterLp, RRAM_LP. */
static int trans_hp_to_lp(void)
{
	cy_en_syspm_status_t st;
	uint32_t t0, t1, t2, t3;

	pm_phase_log_reset("hp2lp");

	t0 = k_cycle_get_32();
	Cy_SysClk_ClkHfSetDivider(0, CY_SYSCLK_CLKHF_DIVIDE_BY_3);
	t1 = k_cycle_get_32();
	st = pm_syspm_enter(PM_MODE_LP);
	t2 = k_cycle_get_32();
	if (st != CY_SYSPM_SUCCESS) {
		Cy_SysClk_ClkHfSetDivider(0, CY_SYSCLK_CLKHF_NO_DIVIDE);
		printk("[pm] HP->LP EnterLp failed (%d)\n", (int)st);
		return -EIO;
	}
	Cy_RRAM_SetVoltageMode(RRAMC0, CY_RRAM_VMODE_LP);
	t3 = k_cycle_get_32();

	pm_phase_log_record("div", t1 - t0);
	pm_phase_log_record("enter", t2 - t1);
	pm_phase_log_record("rram", t3 - t2);
	return 0;
}

/** HP -> ULP (down, direct -- EnterUlp does the two-step voltage
 *  drop internally): /4, EnterUlp, RRAM_ULP. */
static int trans_hp_to_ulp(void)
{
	cy_en_syspm_status_t st;
	uint32_t t0, t1, t2, t3;

	pm_phase_log_reset("hp2ulp");

	t0 = k_cycle_get_32();
	Cy_SysClk_ClkHfSetDivider(0, CY_SYSCLK_CLKHF_DIVIDE_BY_4);
	t1 = k_cycle_get_32();
	st = pm_syspm_enter(PM_MODE_ULP);
	t2 = k_cycle_get_32();
	if (st != CY_SYSPM_SUCCESS) {
		Cy_SysClk_ClkHfSetDivider(0, CY_SYSCLK_CLKHF_NO_DIVIDE);
		printk("[pm] HP->ULP EnterUlp failed (%d)\n", (int)st);
		return -EIO;
	}
	Cy_RRAM_SetVoltageMode(RRAMC0, CY_RRAM_VMODE_ULP);
	t3 = k_cycle_get_32();

	pm_phase_log_record("div", t1 - t0);
	pm_phase_log_record("enter", t2 - t1);
	pm_phase_log_record("rram", t3 - t2);
	return 0;
}

/** LP -> ULP (down): /4, EnterUlp, RRAM_ULP. On failure restore
 *  the LP divider (/3). */
static int trans_lp_to_ulp(void)
{
	cy_en_syspm_status_t st;
	uint32_t t0, t1, t2, t3;

	pm_phase_log_reset("lp2ulp");

	t0 = k_cycle_get_32();
	Cy_SysClk_ClkHfSetDivider(0, CY_SYSCLK_CLKHF_DIVIDE_BY_4);
	t1 = k_cycle_get_32();
	st = pm_syspm_enter(PM_MODE_ULP);
	t2 = k_cycle_get_32();
	if (st != CY_SYSPM_SUCCESS) {
		Cy_SysClk_ClkHfSetDivider(0, CY_SYSCLK_CLKHF_DIVIDE_BY_3);
		printk("[pm] LP->ULP EnterUlp failed (%d)\n", (int)st);
		return -EIO;
	}
	Cy_RRAM_SetVoltageMode(RRAMC0, CY_RRAM_VMODE_ULP);
	t3 = k_cycle_get_32();

	pm_phase_log_record("div", t1 - t0);
	pm_phase_log_record("enter", t2 - t1);
	pm_phase_log_record("rram", t3 - t2);
	return 0;
}

/** ULP -> LP (up): EnterLp (voltage rises), RRAM_LP, /3. */
static int trans_ulp_to_lp(void)
{
	cy_en_syspm_status_t st;
	uint32_t t0, t1, t2, t3;

	pm_phase_log_reset("ulp2lp");

	t0 = k_cycle_get_32();
	st = pm_syspm_enter(PM_MODE_LP);
	t1 = k_cycle_get_32();
	if (st != CY_SYSPM_SUCCESS) {
		printk("[pm] ULP->LP EnterLp failed (%d)\n", (int)st);
		return -EIO;
	}
	Cy_RRAM_SetVoltageMode(RRAMC0, CY_RRAM_VMODE_LP);
	t2 = k_cycle_get_32();
	Cy_SysClk_ClkHfSetDivider(0, CY_SYSCLK_CLKHF_DIVIDE_BY_3);
	t3 = k_cycle_get_32();

	pm_phase_log_record("enter", t1 - t0);
	pm_phase_log_record("rram", t2 - t1);
	pm_phase_log_record("div", t3 - t2);
	return 0;
}

/** LP -> HP (up): EnterHp, RRAM_HP, /1. */
static int trans_lp_to_hp(void)
{
	cy_en_syspm_status_t st;
	uint32_t t0, t1, t2, t3;

	pm_phase_log_reset("lp2hp");

	t0 = k_cycle_get_32();
	st = pm_syspm_enter(PM_MODE_HP);
	t1 = k_cycle_get_32();
	if (st != CY_SYSPM_SUCCESS) {
		printk("[pm] LP->HP EnterHp failed (%d)\n", (int)st);
		return -EIO;
	}
	Cy_RRAM_SetVoltageMode(RRAMC0, CY_RRAM_VMODE_HP);
	t2 = k_cycle_get_32();
	Cy_SysClk_ClkHfSetDivider(0, CY_SYSCLK_CLKHF_NO_DIVIDE);
	t3 = k_cycle_get_32();

	pm_phase_log_record("enter", t1 - t0);
	pm_phase_log_record("rram", t2 - t1);
	pm_phase_log_record("div", t3 - t2);
	return 0;
}

/** ULP -> HP (up, direct -- EnterHp does the two-step voltage rise
 *  internally): EnterHp, RRAM_HP, /1. */
static int trans_ulp_to_hp(void)
{
	cy_en_syspm_status_t st;
	uint32_t t0, t1, t2, t3;

	pm_phase_log_reset("ulp2hp");

	t0 = k_cycle_get_32();
	st = pm_syspm_enter(PM_MODE_HP);
	t1 = k_cycle_get_32();
	if (st != CY_SYSPM_SUCCESS) {
		printk("[pm] ULP->HP EnterHp failed (%d)\n", (int)st);
		return -EIO;
	}
	Cy_RRAM_SetVoltageMode(RRAMC0, CY_RRAM_VMODE_HP);
	t2 = k_cycle_get_32();
	Cy_SysClk_ClkHfSetDivider(0, CY_SYSCLK_CLKHF_NO_DIVIDE);
	t3 = k_cycle_get_32();

	pm_phase_log_record("enter", t1 - t0);
	pm_phase_log_record("rram", t2 - t1);
	pm_phase_log_record("div", t3 - t2);
	return 0;
}

/* ------------------------------------------------------------------
 * Strategy interface (see power_manager_internal.h).
 * ------------------------------------------------------------------ */

void pm_strategy_init(void)
{
	/* No callbacks to register; boot state already matches the HP
	 * mode (ClkHf0 divider /1, DPLL_LP0 at 200 MHz per DT overlay). */
}

int pm_strategy_transition(pm_mode_t source, pm_mode_t target)
{
	switch (source) {
	case PM_MODE_HP:
		if (target == PM_MODE_LP) {
			return trans_hp_to_lp();
		}
		if (target == PM_MODE_ULP) {
			return trans_hp_to_ulp();
		}
		break;
	case PM_MODE_LP:
		if (target == PM_MODE_HP) {
			return trans_lp_to_hp();
		}
		if (target == PM_MODE_ULP) {
			return trans_lp_to_ulp();
		}
		break;
	case PM_MODE_ULP:
		if (target == PM_MODE_HP) {
			return trans_ulp_to_hp();
		}
		if (target == PM_MODE_LP) {
			return trans_ulp_to_lp();
		}
		break;
	default:
		break;
	}
	return -EINVAL;
}

const char *pm_strategy_mode_name(pm_mode_t m)
{
	switch (m) {
	case PM_MODE_HP:
		return "HP  (200 MHz)";
	/* 200 MHz / 3 = 66 MHz -- closest integer divider from 200 to
	 * the 80 MHz LP spec ceiling; unavoidable with this strategy. */
	case PM_MODE_LP:
		return "LP  ( 66 MHz)";
	case PM_MODE_ULP:
		return "ULP ( 50 MHz)";
	default:
		return "UNKNOWN";
	}
}

void pm_strategy_probe_status(void)
{
	printk("[div] approach=divider-only  DPLL frozen at boot value\n");
}

bool pm_strategy_needs_uart_retune(void) { return false; }

void pm_strategy_print_last_phases(void) { pm_phase_log_print(); }

#endif /* PM_STRATEGY_HF0_DIVIDER */
```

## src/shell_cmds.h
```c
/*
 * Copyright (c) 2026
 * SPDX-License-Identifier: Apache-2.0
 */

/**
 * @file
 * @brief Shell command handlers for project 06.
 *
 * The Zephyr shell auto-registers commands at link time via
 * @c SHELL_CMD_REGISTER, so pulling shell_cmds.c into the build is
 * enough -- no runtime registration hook is needed. This header
 * therefore has no public API; it exists only as a placeholder in
 * case future setup (e.g. per-command context registration) is
 * required.
 */

#ifndef APP_SHELL_CMDS_H_
#define APP_SHELL_CMDS_H_

#endif /* APP_SHELL_CMDS_H_ */
```
