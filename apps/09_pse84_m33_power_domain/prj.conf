## CMakeLists.txt
```
# SPDX-License-Identifier: Apache-2.0
cmake_minimum_required(VERSION 3.28.0)

find_package(Zephyr REQUIRED HINTS $ENV{ZEPHYR_BASE})
project(pse84_power_domain)

target_sources(app PRIVATE
    src/main.c
)

target_sources_ifdef(CONFIG_PM_DEVICE_POWER_DOMAIN app PRIVATE
    src/infineon_power_domain.c
)
```

## prj.conf
```kconfig
CONFIG_BUILD_OUTPUT_HEX=y
#CONFIG_SHELL=y
#CONFIG_LOG=y

CONFIG_SERIAL=y
CONFIG_CONSOLE=y
CONFIG_UART_CONSOLE=y
#CONFIG_SHELL_BACKEND_SERIAL=y

#CONFIG_MAIN_STACK_SIZE=2048
CONFIG_PM=y
CONFIG_PM_DEVICE=y #Exposes the pm_device_action_cb to the PM subsystem, enabling pm inside the driver.
CONFIG_PM_DEVICE_RUNTIME=y #Activates device runtime PM. Device Driver indicates when it needs the device
CONFIG_PM_DEVICE_POWER_DOMAIN=y#Enables Power Domain feature.
CONFIG_DEVICE_DEPS=y
CONFIG_BOOT_BANNER=n
#CONFIG_LOG=y
#CONFIG_LOG_DEFAULT_LEVEL=4
#CONFIG_SHELL=y
#CONFIG_SERIAL=y
#CONFIG_CONSOLE=y
#CONFIG_UART_CONSOLE=y
#CONFIG_SHELL_BACKEND_SERIAL=y
#CONFIG_DEVICE_SHELL=y
#CONFIG_LOG=y
#CONFIG_PM_DEVICE_SHELL=y
CONFIG_INSTRUMENTATION_TRIGGER_FUNCTION="instrumentation_trigger"
CONFIG_INSTRUMENTATION=y
CONFIG_INSTRUMENTATION_MODE_CALLGRAPH=y
CONFIG_INSTRUMENTATION_EXCLUDE_FILE_LIST="isr_wrapper,xip,bitmask,version,spi,i2c,adc,pwm,wdt,usb,mem,cy_crypto,cy_ble,cy_tcpwm,cy_adc,cy_dac,cy_smartio,cy_sdhc,cmsis,crypto,dma,cy_mpc,cy_ppc,cy_trigmux,qspi,assert,bitarray"
#CONFIG_INSTRUMENTATION_EXCLUDE_FUNCTION_LIST="pm_device_runtime_is_enabled,device_is_ready,pm_device_is_busy,pm_device_wakeup_is_enabled,pm_device_action_run,main,k_busy_wait,sys_clock_elapsed,any_cpu_announcing,this_cpu_announcin,runq_bes,next_up,update_cache,sys_clock_cycle_get_32,arch_k_cycle_get_32,k_cycle_get_3,arch_irq_lock,arch_irq_unlock,timeout"
CONFIG_INSTRUMENTATION_MODE_CALLGRAPH_TRACE_BUFFER_SIZE=65000
CONFIG_INSTRUMENTATION_MODE_CALLGRAPH_BUFFER_OVERWRITE=y
CONFIG_INSTRUMENTATION_STOPPER_FUNCTION="instrumentation_stopper"
CONFIG_INSTRUMENTATION_DYNAMIC_TRIGGER=n
```

## boards/kit_pse84_eval_pse846gps2dbzc4a_m33.overlay
```dts
/{
	hf_clock_domain_10: hf_clock_domain_10 {
		compatible = "power-domain";
		#power-domain-cells = <0>;
		power-domains = <&clk_path_1_domain>;
		zephyr,pm-device-runtime-auto;
	};
	clk_path_1_domain: clk_path_1_domain{
		compatible = "power-domain";
		#power-domain-cells = <0>;
		zephyr,pm-device-runtime-auto;
	};
};
&scb2{
	zephyr,pm-device-runtime-auto;
	power-domains = <&hf_clock_domain_10>;
};
```

## src/main.c
```c
/*
 * Copyright (c) 2016 Intel Corporation
 *
 * SPDX-License-Identifier: Apache-2.0
 */

#include <stdio.h>
#include <zephyr/kernel.h>
#include <zephyr/drivers/gpio.h>
#include <zephyr/pm/device.h>



/* 1000 msec = 1 sec */

/* The devicetree node identifier for the "led0" alias. */
#define LED0_NODE DT_ALIAS(led0)
const struct device *domain = DEVICE_DT_GET(DT_NODELABEL(hf_clock_domain_10));

/*
 * A build error on this line means your board is unsupported.
 * See the sample documentation for information on how to fix this.
 */
static const struct gpio_dt_spec led = GPIO_DT_SPEC_GET(LED0_NODE, gpios);
volatile int instrumentation_marker;
extern volatile uint32_t flag;

__attribute__((used, noinline))
void instrumentation_trigger(void)
{
    instrumentation_marker = 1;
}
 
__attribute__((used, noinline))
void instrumentation_stopper(void)
{
    instrumentation_marker = 2;
}

int main(void)
{
    enum pm_device_state state;
    int rc;

    rc = pm_device_state_get(domain, &state);
    if (rc == 0) {
        if (state == PM_DEVICE_STATE_ACTIVE) {
            printk("1");
        } else if (state == PM_DEVICE_STATE_SUSPENDED) {
            printk("2");
        } else if (state == PM_DEVICE_STATE_OFF) {
            printk("3");
        }
    }


    k_busy_wait(100000);
    rc = pm_device_state_get(domain, &state);
    if (rc == 0) {
        if (state == PM_DEVICE_STATE_ACTIVE) {
            printk("4");
        } else if (state == PM_DEVICE_STATE_SUSPENDED) {
            printk("5");
        } else if (state == PM_DEVICE_STATE_OFF) {
            printk("6");
        }
    }

    while (1) {
        k_busy_wait(100000);
    	rc = pm_device_state_get(domain, &state);

	
    }
    return 0;
}
```

## src/infineon_power_domain.c
```c
#include <infineon_kconfig.h>
#include <zephyr/drivers/clock_control.h>
#include <zephyr/drivers/clock_control/clock_control_ifx_cat1.h>
#include <zephyr/dt-bindings/clock/ifx_clock_source_common.h>
#include <zephyr/dt-bindings/clock/ifx_clock_source_boards.h>
#include <zephyr/pm/device.h>
#include <zephyr/pm/device_runtime.h>
#include <zephyr/kernel.h>


#define DT_DRV_COMPAT power_domain


volatile uint32_t flag = 0;

static int clock_domain_pd_action(const struct device *dev, enum pm_device_action action)
{
	int err;
    	switch (action) {
    		case PM_DEVICE_ACTION_RESUME:
			flag = 1;
    			err = Cy_SysClk_ClkHfEnable(10u);
        		//pm_device_children_action_run(dev, PM_DEVICE_ACTION_TURN_ON, NULL);
        		break;
    		case PM_DEVICE_ACTION_SUSPEND:
			//flag = 2;
        		//pm_device_children_action_run(dev, PM_DEVICE_ACTION_TURN_OFF, NULL);;
			err = Cy_SysClk_ClkHfDisable(10u);
        		break;
    		case PM_DEVICE_ACTION_TURN_ON:
			//flag = 3;
			//err = Cy_SysClk_ClkHfEnable(10u);
        		break;
    		case PM_DEVICE_ACTION_TURN_OFF:
			//flag = 4;
			//err = Cy_SysClk_ClkHfDisable(10u);
        		break;
    		default:
        		return -ENOTSUP;
    }
	return 0;
}

static int clock_domain_pd_init(const struct device *dev){
	return pm_device_driver_init(dev, clock_domain_pd_action);
}

#define INFINEON_CLOCK_PD_INIT(n)                                               \
        PM_DEVICE_DT_INST_DEFINE(n, clock_domain_pd_action);                    \
	DEVICE_DT_INST_DEFINE(n, &clock_domain_pd_init,                     	\
                          PM_DEVICE_DT_INST_GET(n),                             \
                          NULL,                        				\
                          NULL,                         			\
                          PRE_KERNEL_1,                                    	\
                          11,                     				\
                          NULL);

DT_INST_FOREACH_STATUS_OKAY(INFINEON_CLOCK_PD_INIT)
```
