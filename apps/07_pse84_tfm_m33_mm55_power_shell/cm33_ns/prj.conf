## CMakeLists.txt
```
cmake_minimum_required(VERSION 3.20.0)

find_package(Zephyr REQUIRED HINTS $ENV{ZEPHYR_BASE})

# Inject the z_pm out-of-tree TF-M secure partition into the TF-M build.
# Set after find_package(Zephyr) so zephyr_property_target exists, but
# before project() so the TF-M ExternalProject CMake picks it up.
set(Z_PM_PARTITION_DIR ${CMAKE_CURRENT_LIST_DIR}/../tfm_partitions/z_pm)
set_property(TARGET zephyr_property_target
    APPEND PROPERTY TFM_CMAKE_OPTIONS
    -DTFM_EXTRA_MANIFEST_LIST_FILES=${Z_PM_PARTITION_DIR}/manifest_list.yaml
    -DTFM_EXTRA_PARTITION_PATHS=${Z_PM_PARTITION_DIR}
    # Halt (spin) in tfm_core_panic instead of doing NVIC_SystemReset,
    # so a debugger can read the exception frame that BusFault_Handler
    # / SecureFault_Handler stashed via EXCEPTION_INFO(). Inherited from
    # project 02. Remove for production builds.
    -DCONFIG_TFM_HALT_ON_CORE_PANIC=ON
)

project(pse84_tfm_m33_mm55_power_shell_cm33ns)

# NOTE: project 02 dropped ${ZEPHYR_BASE}/soc/infineon/edge/pse84/power.c
# from the build because its pm_state_set bus-faults from NS when
# CONFIG_PM=y. This project sets CONFIG_PM=n (shell drives PM directly,
# no Zephyr residency policy), so pm_state_set is never reached and
# the SoC's power.c can stay linked in as-is. No CMake surgery.

target_sources(app PRIVATE
    src/main.c
    src/boot_mcwdt_reset.c
    src/gpio_indicators.c
    src/diag.c
    src/pm_phase_log.c
    src/power_manager.c
    src/shell_cmds.c
    src/cmd_noidle.c
    src/cmd_sleep.c
    src/cmd_deep_sleep.c
    src/z_pm_client.c
)

# Pick up psa_manifest/sid.h generated by the TF-M build (provides
# Z_PM_SERVICE_HANDLE for the partition we injected above).
target_include_directories(app PRIVATE
    $<TARGET_PROPERTY:tfm,TFM_BINARY_DIR>/api_ns/interface/include
)
```

## Kconfig
```
# App-level Kconfig for project 07.
#
# Zephyr's ARM_ON_ENTER_CPU_IDLE_HOOK symbol has no user prompt and
# can only be turned on via `select` from another Kconfig. Provide a
# thin app-visible wrapper so prj.conf can toggle it. Identical
# mechanism to project 06's Kconfig.

mainmenu "Options for pse84_tfm_m33_mm55_power_shell"

config APP_ENABLE_IDLE_HOOK
	bool "Enable ARM idle-entry hook (required by the `noidle` shell command)"
	default y
	select ARM_ON_ENTER_CPU_IDLE_HOOK
	help
	  Enables the z_arm_on_enter_cpu_idle() hook so the `noidle`
	  shell command can veto WFI in the idle thread. With this off,
	  `noidle on` is a no-op (idle keeps entering WFI regardless of
	  the flag).

source "Kconfig.zephyr"
```

## prj.conf
```kconfig
# Application configuration for CM33 non-secure image of project 07.
#
# Fuses project 02's TF-M paired-build scaffolding with project 06's
# shell-driven power-mode UX. Deliberately omits CONFIG_PM: the shell
# owns HP/LP/ULP + sleep + deep_sleep entry directly, no Zephyr PM
# residency policy runs.

# ---------- TF-M paired-build ------------------------------------------------

# Emit a hex image alongside the ELF; needed for `west flash`.
CONFIG_BUILD_OUTPUT_HEX=y

# Enable the TF-M mailbox/relay so the CM55 non-secure image can reach
# the TF-M Secure Processing Environment running on this CM33-NS core.
# Also triggers soc_pse84_m33_ns.c to call Cy_SysEnableCM55 at boot,
# which is what unblocks system-DEEPSLEEP voting later. Must be set on
# BOTH the CM33-NS and CM55 images.
CONFIG_PSOC_EDGE_M55_SRF_SUPPORT=y

# Idle stack must fit tfm_ns_interface_dispatch's fpu_ctx_full alloca
# (136 bytes) plus everything on top -- see the file-header comment in
# project 02's cm33_ns/src/power.c. The Zephyr default (320 B) blows
# past PSPLIM on the deepest NS->S chains. 2048 gives ample headroom.
CONFIG_IDLE_STACK_SIZE=2048
CONFIG_MAIN_STACK_SIZE=4096

# Diagnostics: stack canary + full fault-frame dump on hard fault.
CONFIG_INIT_STACKS=y
CONFIG_FAULT_DUMP=2

# ---------- Zephyr PM (disabled) --------------------------------------------

# Explicitly NOT set:
#   CONFIG_PM=y             -- shell drives every PM transition,
#                              no residency policy needed.
#   CONFIG_PM_POLICY_DEFAULT
#   CONFIG_TICKLESS_KERNEL  -- kept at project defaults; not required
#                              without a PM policy.

# ---------- Shell + `noidle` idle-hook (from project 06) ---------------------

# Zephyr shell over the SCB2 UART console.
CONFIG_SHELL=y

# Shell serial backend: polling instead of IRQ-driven.
#
# TEMPORARY: on CM33-NS under TF-M on this SoC/build, enabling the
# IRQ-driven serial backend produces "Unhandled IRQn: 121" the moment
# the shell RX enables the UART interrupt. IRQ 121 on the CM33 map is
# tcpwm_0_interrupts_259, so this looks like an interrupt routing /
# NVIC-line mismatch specific to the CM33-NS + TF-M multicore build
# path -- project 06 (CM33-S, no TF-M) uses IRQ-driven fine at IRQ 143
# for the same SCB2. To investigate later; polling backend is a stable
# workaround for the demo.
CONFIG_UART_INTERRUPT_DRIVEN=n
CONFIG_SHELL_BACKEND_SERIAL_API_POLLING=y

# Raise the shell RX poll period from the 10 ms default to 500 ms so
# the resulting CPU-wake spike train drops from ~77 Hz to ~2 Hz. That
# is far more forgiving for PPK2-based DVFS current measurements
# (windowing between spikes / averaging is easy at 2 Hz) at the cost
# of a mean 250 ms keypress-echo latency, which is imperceptible for
# interactive shell commands but noticeable if you paste a long
# script. Change back to 10 (or fix the IRQ backend, see comment
# above) if the demo starts feeling sluggish.
CONFIG_SHELL_BACKEND_SERIAL_RX_POLL_PERIOD=500

# Enable z_arm_on_enter_cpu_idle() so the `noidle` shell command can
# veto WFI in the idle thread. Symbol is promptless in upstream
# Zephyr; the app-local Kconfig defines APP_ENABLE_IDLE_HOOK which
# selects it. The hook function itself is defined in src/cmd_noidle.c.
CONFIG_APP_ENABLE_IDLE_HOOK=y

# ---------- Kernel tick on MCWDT0 (survives DeepSleep) -----------------------

# SysTick is clocked from HF0 (CM33 core clock), which future phases
# reprogram per HP/LP/ULP. That would make k_msleep / k_cycle_get_32
# report 3-4x too long at LP/ULP. MCWDT0 runs off PILO (32.768 kHz),
# independent of every HF clock and alive across CPU deep sleep too,
# so it doubles as a deep-sleep wake source.
CONFIG_CORTEX_M_SYSTICK=n
CONFIG_INFINEON_LP_TIMER_PDL=y
CONFIG_SYS_CLOCK_HW_CYCLES_PER_SEC=32768

# ---------- Peripherals -----------------------------------------------------

CONFIG_GPIO=y

# ---------- TF-M diagnostics -------------------------------------------------

# Verbose SPM logs + exception-frame dump on fatal errors in the SPE.
# TFM_HALT_ON_CORE_PANIC is applied via TFM_CMAKE_OPTIONS in
# CMakeLists.txt (not a Kconfig here).
CONFIG_TFM_SPM_LOG_LEVEL_DEBUG=y
CONFIG_TFM_EXCEPTION_INFO_DUMP=y
```

## src/main.c
```c
/*
 * Copyright (c) 2026
 * SPDX-License-Identifier: Apache-2.0
 *
 * CM33 non-secure application bring-up for
 * apps/07_pse84_tfm_m33_mm55_power_shell.
 *
 * Phase C (shell layer): banner + GPIO indicator init + z_pm PING
 * round-trip + power-mode manager init. The following shell commands
 * are registered automatically at link time (via SHELL_CMD_REGISTER):
 *
 *   noidle [on|off]    -- veto WFI in idle thread (see src/cmd_noidle.c)
 *   sleep              -- Cy_SysPm_CpuEnterSleep     (src/cmd_sleep.c)
 *   deep_sleep         -- Cy_SysPm_CpuEnterDeepSleep (src/cmd_deep_sleep.c)
 *   hp / lp / ulp      -- Phase-C STUB, prints "not implemented"
 *   probe              -- Phase-C STUB, prints "not implemented"
 *
 * Phase D wires hp / lp / ulp / probe into a new set of z_pm ops:
 *   - Z_PM_OP_SWITCH_ACTIVE_MODE (mode transition body)
 *   - Z_PM_OP_CLOCK_PROBE (frequency measurement)
 *   - Z_PM_OP_DEEP_SLEEP_BIAS (called from here at boot, lowers the
 *     `deep_sleep` sleep-floor from ~today to the AN237976 Table-2
 *     row target -- see PLAN.md sec. 5.3)
 *   - Z_PM_OP_BOOT_CLOCK_RETUNE (DPLL_LP0 400 MHz -> 200 MHz + HF0
 *     /2 -> /1, called from here at boot to match project 06's
 *     baseline clock tree)
 *
 * At the end of Phase C: shell prompt appears, `sleep`/`deep_sleep`
 * enter their respective states and wake on the LPTIMER tick,
 * `noidle` correctly toggles the idle-thread WFI. `deep_sleep`
 * currently reaches a higher sleep floor than optimal because the
 * BGREF/CoreBuck/IHO/IMO DS-bias registers (all Bucket-C, PC=2 only)
 * still hold TF-M cycfg defaults; Phase D's DEEP_SLEEP_BIAS op fixes
 * this.
 */

#include <stdio.h>

#include <zephyr/kernel.h>

#include "gpio_indicators.h"
#include "power_manager.h"
#include "z_pm_client.h"

int main(void)
{
	printf("CM33-NS power-shell on %s\n", CONFIG_BOARD);

	if (gpio_indicators_init() < 0) {
		printf("gpio_indicators_init failed -- LEDs / pm_busy pin "
		       "will be dark\n");
	}

	/* Prove the z_pm out-of-tree TF-M partition + PSA call
	 * infrastructure is intact end-to-end. Non-fatal: a failure
	 * here does not prevent the shell from coming up, but every
	 * subsequent Phase-D op will also fail. */
	uint32_t cookie = 0;
	psa_status_t st = z_pm_ping(&cookie);

	if (st == PSA_SUCCESS && cookie == Z_PM_PING_COOKIE) {
		printf("z_pm ping ok: cookie=0x%08x\n", cookie);
	} else {
		printf("z_pm ping FAIL: status=%d cookie=0x%08x\n", (int)st,
		       cookie);
	}

	pm_init();
	printf("initial power mode: %s (stub -- Phase D wires the real "
	       "switcher)\n",
	       pm_mode_name(pm_current_mode()));

	return 0;
}
```

## src/cmd_deep_sleep.c
```c
/*
 * Copyright (c) 2026
 * SPDX-License-Identifier: Apache-2.0
 */

/**
 * @file
 * @brief `deep_sleep` shell command -- put CM33-NS into CPU Deep
 *        Sleep until the next NVIC IRQ (typically an LPTIMER tick).
 *
 * Relationship to `sleep`:
 *
 *   sleep       Cy_SysPm_CpuEnterSleep       -- just WFI. CPU pipeline
 *                                               halts, all clocks and
 *                                               peripherals stay alive.
 *                                               Buck at active voltage.
 *
 *   deep_sleep  Cy_SysPm_CpuEnterDeepSleep   -- SLEEPDEEP bit set, then
 *                                               WFI. Enables buck to drop
 *                                               to 0.70V LP topology, HF
 *                                               clocks to gate, IHO/IMO
 *                                               to stop, BGREF to go LP.
 *
 * On this project's CM33-NS build, both entry points are SRF-wrapped
 * by the PDL (`CY_PDL_SYSPM_ENABLE_SRF_INTEG`) -- the NS call packs a
 * request into IFX_EXT_SP and TF-M-S runs the actual SLEEPDEEP + WFI
 * at PC=2 on our behalf. The direct PDL call from NS is therefore
 * the correct dispatch path; no project-local z_pm wrap is needed
 * for CpuEnter{Sleep,DeepSleep}.
 *
 * System-DEEPSLEEP voting: this project's CM55 image (see cm55/)
 * arms Cy_SysPm_SetDeepSleepMode(DEEPSLEEP) at its own boot then
 * parks in an infinite Cy_SysPm_CpuEnterDeepSleep loop with IRQs
 * masked. So the moment CM33-NS executes WFI here, both CPUs have
 * voted DS and the PWRMODE state machine can collapse to a real
 * AN237976 Table-2 DEEPSLEEP row -- the whole reason for the
 * project's dual-core structure. That is the difference vs.
 * project 06, where CM55 never boots and the SoC bottoms out at
 * CPU-DEEPSLEEP (no PPU retention fold, ~62 uA floor).
 *
 * Layer of prep NOT done here yet (Phase D):
 *
 *   Project 06 has a PRE_KERNEL_2 SYS_INIT hook
 *   (pm_deep_sleep_init) that programs SRSS_PWR_CTL2 BGREF_LPMODE,
 *   CoreBuck DS voltage/mode/override, IHO/IMO DS-off, and
 *   Cy_SysPm_SetDeepSleepMode(DEEPSLEEP). Every register touched by
 *   that hook is in the PWRMODE_PWRMODE / SRSS_MAIN PPC regions
 *   which are PC=2 only on this build, so the sequence must go
 *   through the z_pm partition (Z_PM_OP_DEEP_SLEEP_BIAS, plan
 *   sec. 5.3). Phase D adds the op + the client stub + the boot-
 *   time call from main(). Until then, deep_sleep still WORKS --
 *   it correctly enters CPU-DS and wakes on LPTIMER -- but the
 *   sleep-floor current is higher than optimal because the DS
 *   bias registers stay at their TF-M cycfg defaults.
 *
 * Wake source: MCWDT0/LPTIMER on PILO, alive across Deep Sleep by
 * design (PILO is a deep-sleep-alive clock). k_msleep(20) at the top
 * of the handler schedules the next Zephyr deadline, and that is
 * what wakes us. UART RX does NOT wake System Deep Sleep (only SCB0
 * supports DS wake; our shell UART is on SCB2).
 *
 * Per-entry sequence (this file):
 *
 *   1. pm-busy HIGH, banner print, k_msleep(20) TX drain.
 *   2. pm-busy LOW -- WFI window starts.
 *   3. PRIMASK on, BASEPRI off, __DSB.
 *   4. Cy_SysPm_CpuEnterDeepSleep(WAIT_FOR_INTERRUPT) -- SRF-wrapped;
 *      TF-M-S sets SLEEPDEEP, executes WFI at PC=2.
 *   5. On wake, clear SLEEPDEEP so that any subsequent Zephyr idle
 *      WFI is plain CPU sleep (not another deep sleep from the same
 *      thread).
 *   6. __enable_irq, pm-busy HIGH, print dwell, pm-busy LOW.
 */

#include <zephyr/kernel.h>
#include <zephyr/shell/shell.h>
#include <zephyr/sys/time_units.h>

#include <cmsis_core.h>
#include <cy_pdl.h>
#include <cy_syspm.h>

#include <stddef.h>

#include "gpio_indicators.h"

/**
 * @brief Shell handler for `deep_sleep`.
 *
 * Semantics identical to @c cmd_sleep except the entry API is
 * @c Cy_SysPm_CpuEnterDeepSleep (SLEEPDEEP asserted before WFI)
 * and SLEEPDEEP is cleared on wake to keep Zephyr's idle-thread
 * WFI as plain CPU sleep afterwards.
 */
static int cmd_deep_sleep(const struct shell *sh, size_t argc, char **argv)
{
	ARG_UNUSED(argc);
	ARG_UNUSED(argv);

	gpio_indicators_transition_begin();

	shell_print(sh, "entering CPU deep sleep -- wakes on LPTIMER tick");

	/* Let the shell TX ring drain before WFI. With mcwdt0 as the
	 * Zephyr system timer, k_msleep(20) really waits 20 ms at
	 * every HP/LP/ULP mode -- comfortable margin for ~60 chars at
	 * 115200 baud (~5 ms actual drain). */
	k_msleep(20);

	gpio_indicators_transition_end();

	uint32_t t_enter = k_cycle_get_32();

	/* PRIMASK on, BASEPRI off -- see cmd_sleep.c file-comment. */
	__disable_irq();
	irq_unlock(0);
	__DSB();
	(void)Cy_SysPm_CpuEnterDeepSleep(CY_SYSPM_WAIT_FOR_INTERRUPT);
	SCB_SCR &= (uint32_t)~SCB_SCR_SLEEPDEEP_Msk;
	__enable_irq();

	uint32_t t_exit = k_cycle_get_32();

	gpio_indicators_transition_begin();

	uint32_t dwell_cyc = t_exit - t_enter;
	uint32_t dwell_us = k_cyc_to_us_floor32(dwell_cyc);

	shell_print(sh, "woke after %u us (%u LPTIMER cycles @ 32768 Hz)",
		    dwell_us, dwell_cyc);

	gpio_indicators_transition_end();
	return 0;
}

SHELL_CMD_REGISTER(deep_sleep, NULL,
		   "Enter CPU Deep Sleep (SLEEPDEEP + WFI) until any NVIC IRQ "
		   "(LPTIMER tick). Pair with `noidle on` to see the "
		   "active-vs-deep-sleep current delta.",
		   cmd_deep_sleep);
```

## src/diag.c
```c
/*
 * Copyright (c) 2026
 * SPDX-License-Identifier: Apache-2.0
 *
 * See diag.h for the diagnosis matrix and rationale.
 */

#include "diag.h"

#include <stdint.h>

#include <zephyr/device.h>
#include <zephyr/drivers/gpio.h>
#include <zephyr/kernel.h>

/*
 * SCB2 register block base. Hard-coded rather than derived from DT
 * because we deliberately want to poke this SCB even when the Zephyr
 * driver's cached configuration might be broken.
 *
 * PSE84 exposes SCB2 through two AHB aliases; the correct one depends
 * on the security state of the accessing bus master:
 *
 *   Non-Secure alias (M33-NS / M55-NS code):  0x429a0000
 *   Secure     alias (M33-S code):            0x529a0000
 *
 * This project (07) builds for `kit_pse84_eval/pse846gps2dbzc4a/m33/ns`
 * under TF-M -- CM33 Non-Secure -- so we MUST use the Non-Secure
 * alias. Writing the Secure alias 0x529a0000 from NS raises a
 * BusFault ("peripheral not accessible from current security state")
 * that escalates to HardFault. Project 06 used 0x529a0000 because it
 * ran from CM33-Secure without TF-M; the two projects deliberately
 * pin different aliases in this one line and are otherwise identical.
 *
 * The pse84.dtsi node for the NS alias:
 *   scb2: scb@429a0000 { reg = <0x429a0000 0xfd0>; ... }
 *
 * SCB register offsets from Infineon `pdl/devices/include/ip/cyip_scb.h`
 * (verified: TX_FIFO_STATUS at 0x208, TX_FIFO_WR at 0x240 -- these
 * are IP-version-stable on the PSE84 SCB v3):
 *   TX_FIFO_STATUS  0x208   bits[8:0]  = USED entry count
 *                           bit  15    = SR_VALID (TX shift reg has a byte)
 *   TX_FIFO_WR      0x240   write here to enqueue a byte
 *
 * Earlier revisions of this file tried to use INTR_TX.UART_DONE
 * (offset 0xF80, bit 9) for the "TX complete" check. UART_DONE is a
 * LATCHED interrupt bit -- it only re-asserts on the transition
 * from "TX busy" to "TX idle". If the FIFO is already empty when
 * diag_trace_flush() is called (which is the norm at the end of
 * pm_switch_to, because pm_pll_reconfigure() flushed inside the
 * callback and nothing else was queued in the meantime), UART_DONE
 * never transitions and the flush spins forever, freezing the
 * console.
 *
 * TX_FIFO_STATUS.{USED, SR_VALID} are STATE bits, not latches --
 * safe to poll unconditionally. This mirrors the PDL helper
 * Cy_SCB_IsTxComplete() which uses exactly these two fields.
 */
#define APP_SCB2_BASE 0x429a0000u
#define APP_SCB2_TX_FIFO_STATUS (*(volatile uint32_t *)(APP_SCB2_BASE + 0x208u))
#define APP_SCB2_TX_FIFO_WR (*(volatile uint32_t *)(APP_SCB2_BASE + 0x240u))

/* From cyip_scb.h SCB_TX_FIFO_STATUS_{USED,SR_VALID}_Msk -- exposed
 * here as local constants so the raw-SCB path stays completely
 * independent of the PDL. */
#define APP_SCB2_TX_FIFO_STATUS_USED_Msk 0x000001FFu
#define APP_SCB2_TX_FIFO_STATUS_SR_VALID_Msk 0x00008000u

/*
 * SCB v3 TX FIFO on PSE84 is 256 entries deep, but the block is
 * initialised with a smaller effective depth. Waiting until USED
 * drops below 16 leaves plenty of headroom and matches the reference
 * implementation's threshold.
 */
#define APP_SCB2_TX_FIFO_HEADROOM 16u

void diag_trace_char(char c)
{
	while ((APP_SCB2_TX_FIFO_STATUS & APP_SCB2_TX_FIFO_STATUS_USED_Msk) >=
	       APP_SCB2_TX_FIFO_HEADROOM) {
		/* spin — wait for TX FIFO room */
	}
	APP_SCB2_TX_FIFO_WR = (uint32_t)(uint8_t)c;
}

void diag_trace(const char *s)
{
	if (s == NULL) {
		return;
	}
	while (*s != '\0') {
		if (*s == '\n') {
			diag_trace_char('\r');
		}
		diag_trace_char(*s);
		s++;
	}
}

void diag_trace_flush(void)
{
	/* Wait until both the TX FIFO and the shift register are empty.
	 * Both fields live in TX_FIFO_STATUS -- one register read per
	 * loop iteration. Naturally returns immediately if the SCB is
	 * already idle, because both fields are true state (not latches
	 * that need a fresh transition to re-arm). Equivalent to the
	 * PDL's Cy_SCB_IsTxComplete(). */
	const uint32_t busy_mask = APP_SCB2_TX_FIFO_STATUS_USED_Msk |
				   APP_SCB2_TX_FIFO_STATUS_SR_VALID_Msk;

	while ((APP_SCB2_TX_FIFO_STATUS & busy_mask) != 0u) {
		/* spin */
	}
}

/*
 * Heartbeat thread ---------------------------------------------------
 *
 * Owns led2 (blue) exclusively so its blink rate is a pure indicator
 * of CPU liveness. Independent of console, Zephyr shell backend, and
 * any mode-transition side-effect. If the blue LED continues blinking
 * at ~2 Hz after a console "freeze", the CPU is still executing
 * scheduled threads — the fault must be in the console path (Zephyr
 * shell task, SCB UART driver, or the shell's ring-buffer).
 *
 * Uses a low-priority preemptible thread so it never starves the
 * shell RX / TX handlers. Cooperative would be fine too but we keep
 * it preemptible for identical behaviour under HP/LP/ULP.
 */
static const struct gpio_dt_spec led_heartbeat =
    GPIO_DT_SPEC_GET(DT_ALIAS(led2), gpios);

#define HEARTBEAT_STACK_SIZE 512
#define HEARTBEAT_PRIORITY 10 /* preemptible, well below shell */

static void heartbeat_entry(void *a, void *b, void *c)
{
	ARG_UNUSED(a);
	ARG_UNUSED(b);
	ARG_UNUSED(c);

	if (!gpio_is_ready_dt(&led_heartbeat)) {
		return;
	}
	(void)gpio_pin_configure_dt(&led_heartbeat, GPIO_OUTPUT_INACTIVE);

	for (;;) {
		(void)gpio_pin_toggle_dt(&led_heartbeat);
		k_msleep(500);
	}
}

K_THREAD_DEFINE(heartbeat_tid, HEARTBEAT_STACK_SIZE, heartbeat_entry, NULL,
		NULL, NULL, HEARTBEAT_PRIORITY, 0, 0);
```

## src/gpio_indicators.c
```c
/*
 * Copyright (c) 2026
 * SPDX-License-Identifier: Apache-2.0
 *
 * GPIO indicators: mode LEDs (red / green) + PM-busy scope trigger
 * (P3.1). See gpio_indicators.h for the module rationale.
 */

#include "gpio_indicators.h"

#include <errno.h>

#include <zephyr/devicetree.h>
#include <zephyr/drivers/gpio.h>

/** @brief Devicetree handle for led0 (red -- LP indicator). */
static const struct gpio_dt_spec led_red =
    GPIO_DT_SPEC_GET(DT_ALIAS(led0), gpios);

/** @brief Devicetree handle for led1 (green -- ULP indicator). */
static const struct gpio_dt_spec led_green =
    GPIO_DT_SPEC_GET(DT_ALIAS(led1), gpios);

/** @brief Devicetree handle for the PM-busy scope trigger on P3.1.
 *
 *  Declared in the app-local overlay
 *  (`boards/kit_pse84_eval_pse846gps2dbzc4a_m33.overlay`) as
 *  `pm_signals/pm_busy { gpios = <&gpio_prt3 1 GPIO_ACTIVE_HIGH>; }`
 *  with the alias `pm-busy`.
 */
static const struct gpio_dt_spec pm_busy =
    GPIO_DT_SPEC_GET(DT_ALIAS(pm_busy), gpios);

int gpio_indicators_init(void)
{
	if (!gpio_is_ready_dt(&led_red) || !gpio_is_ready_dt(&led_green) ||
	    !gpio_is_ready_dt(&pm_busy)) {
		return -ENODEV;
	}
	if (gpio_pin_configure_dt(&led_red, GPIO_OUTPUT_INACTIVE) < 0 ||
	    gpio_pin_configure_dt(&led_green, GPIO_OUTPUT_INACTIVE) < 0 ||
	    gpio_pin_configure_dt(&pm_busy, GPIO_OUTPUT_INACTIVE) < 0) {
		return -EIO;
	}
	return 0;
}

void gpio_indicators_set_mode_leds(int red, int green)
{
	(void)gpio_pin_set_dt(&led_red, red);
	(void)gpio_pin_set_dt(&led_green, green);
}

void gpio_indicators_transition_begin(void)
{
	(void)gpio_pin_set_dt(&pm_busy, 1);
}

void gpio_indicators_transition_end(void)
{
	(void)gpio_pin_set_dt(&pm_busy, 0);
}
```

## src/pm_phase_log.h
```c
/*
 * Copyright (c) 2026
 * SPDX-License-Identifier: Apache-2.0
 */

/**
 * @file
 * @brief Small in-memory log of cycle-count deltas for named phases
 *        within a single DVFS transition.
 *
 * Filled in by the active DVFS strategy (see
 * @c src/power_manager_hf0_divider.c,
 * @c src/power_manager_pll_retune.c) via
 * @c pm_phase_log_reset() at the start of a transition and repeated
 * @c pm_phase_log_record() calls between the transition's PDL
 * primitives. Dumped by @c pm_phase_log_print() from
 * @c pm_switch_to() right after its aggregate "[pm] transition ..."
 * line.
 *
 * The log stores RAW SysTick cycle counts, not microseconds. The
 * CPU frequency changes several times mid-transition (source ->
 * IHO bypass -> intermediate -> IHO bypass -> target for PLL
 * retune; source -> target for HF0 divider), and no single-rate
 * conversion is correct for the whole span -- so the firmware
 * side prints cycles and leaves wall-time authority to external
 * instrumentation (PPK2 D7 GPIO pulse, scope on P3.1, ...).
 * Post-processing (scripts/postprocess.py) cross-references cycle
 * counts with PPK2-observed pulse widths.
 *
 * Single-slot: only the most recent transition is stored. That is
 * sufficient because @c pm_switch_to() is the sole consumer and
 * flushes the log right after each call.
 */

#ifndef PM_PHASE_LOG_H_
#define PM_PHASE_LOG_H_

#include <stdint.h>

#ifdef __cplusplus
extern "C" {
#endif

/** Discard any prior record and set the transition label
 *  (printed as "[pm] <label> phase cycles: ..."). @p label must
 *  remain valid until the next @c pm_phase_log_print() call --
 *  pass a string literal. */
void pm_phase_log_reset(const char *label);

/** Append a named phase.
 *
 *  @param name    Human-readable phase label; must remain valid
 *                 until the next @c pm_phase_log_print(). Pass a
 *                 string literal.
 *  @param cycles  Cortex-M SysTick cycle count elapsed during the
 *                 phase (delta of two @c k_cycle_get_32() reads).
 *                 Raw count -- do NOT convert to us here, because
 *                 the CPU clock rate changes across phases.
 */
void pm_phase_log_record(const char *name, uint32_t cycles);

/** Emit one line:
 *    [pm] <label> phase cycles: name1=NN name2=NN ... total=NN
 *  Values are raw cycle counts. No-op if the log is empty. */
void pm_phase_log_print(void);

/** Total cycles across the recorded phases (sum). Returns 0 if
 *  the log is empty. */
uint32_t pm_phase_log_total_cycles(void);

#ifdef __cplusplus
}
#endif

#endif /* PM_PHASE_LOG_H_ */
```

## src/power_manager.c
```c
/*
 * Copyright (c) 2026
 * SPDX-License-Identifier: Apache-2.0
 */

/**
 * @file
 * @brief NS-side dispatcher for the HP <-> LP power-mode manager.
 *
 * ULP is intentionally not supported on this build. See
 * `INVESTIGATION_pse84_ulp.md` for the analysis: SPM state and S-side
 * stacks live in SRAM whose reliable-read window at 0.7 V requires an
 * SRAM_TRIM_POST write that can only be issued from NS -- but between
 * the S-side CoreBuck change and the NS post-trim write SPM does a
 * PendSV round-trip through SRAM at the mistrimmed corner. Every
 * mitigation we tried (PRIMASK, HF0 /16 slow-down, atomic PDL
 * SystemEnterUlp from S) hits one wall or another (PPC / SRF path /
 * frequency floor).
 *
 * Security-model split for HP <-> LP:
 *
 *   NS direct writes:
 *     - SRSS RAM_TRIM_STRUCT       -- PPC permits Master-0 (NS master)
 *                                     but blocks Master-1 (S master).
 *
 *   S-side via z_pm Z_PM_OP_SWITCH_ACTIVE_MODE:
 *     - Cy_SysClk_ClkHfSetDivider              -- HF0 divider write.
 *     - Cy_SysPm_CoreBuckSetProfile + Status   -- SRSS_MAIN, S-only.
 *     - Cy_SysPm_SramLdoEnable                 -- reserved for LP<->ULP.
 *
 * Interrupt handling:
 *   Even for the HP <-> LP window we mask NS interrupts using PRIMASK
 *   (`cpsid i` / `cpsie i`) across pre-trim + psa_call + post-trim.
 *   PRIMASK gives a hard guarantee no exception entry fires while
 *   voltage is mid-transition.
 *
 * The SRAM_TRIM sequences are ported verbatim from the DSL PDL
 * `Cy_SysPm_SystemTransition{HpToLp,LpToHp}` bodies.
 */

#include "power_manager.h"

#include <errno.h>

#include <zephyr/kernel.h>
#include <zephyr/sys/printk.h>

#include "cy_pdl.h"
#include "cy_syspm.h"

#include "gpio_indicators.h"
#include "z_pm_client.h"

/** Current active power mode. */
static pm_mode_t s_current_mode = PM_MODE_HP;

const char *pm_mode_name(pm_mode_t m)
{
	switch (m) {
	case PM_MODE_ULP:
		return "ULP (unsupported on this build)";
	case PM_MODE_LP:
		return "LP  ( 66 MHz target)";
	case PM_MODE_HP:
		return "HP  (200 MHz target)";
	default:
		return "?";
	}
}

static const char *pm_mode_short(pm_mode_t m)
{
	switch (m) {
	case PM_MODE_ULP:
		return "ulp";
	case PM_MODE_LP:
		return "lp";
	case PM_MODE_HP:
		return "hp";
	default:
		return "?";
	}
}

pm_mode_t pm_current_mode(void) { return s_current_mode; }

void pm_init(void) { s_current_mode = PM_MODE_HP; }

/* -------------------------------------------------------------------
 * SRAM_TRIM sequences ported verbatim from the DSL PDL's
 * Cy_SysPm_SystemTransition{HpToLp,LpToHp,UlpToLp,LpToUlp}. Each
 * table lists (index, value) writes to SRSS_TRIM_RAM_CTL[index];
 * `pre` writes run before the CoreBuck profile change, `post` writes
 * run after.
 * ------------------------------------------------------------------- */

struct trim_write {
	uint8_t index;
	uint32_t value;
};

/* HP -> LP pre-buck (from Cy_SysPm_SystemTransitionHpToLp steps 2-5). */
static const struct trim_write trim_hp_to_lp_pre[] = {
    {0, 0x343}, {1, 0x343}, {2, 0x206}, {3, 0x206}, {4, 0x20F}, {5, 0x20F},
    {6, 0x3F},	{7, 0x3F},  {8, 0xB},	{2, 0x204}, {3, 0x204}, {4, 0x20C},
    {5, 0x20C}, {6, 0x2D},  {7, 0x2D},	{4, 0x204}, {5, 0x204}, {0, 0x743},
    {1, 0x743}, {2, 0x604}, {3, 0x604}, {6, 0x22D}, {7, 0x22D},
};

/* HP -> LP post-buck (step 7). */
static const struct trim_write trim_hp_to_lp_post[] = {
    {4, 0x604},
    {5, 0x604},
};

/* LP -> HP pre-buck (steps 2-5). */
static const struct trim_write trim_lp_to_hp_pre[] = {
    {2, 0x606}, {3, 0x606}, {4, 0x606}, {5, 0x606}, {6, 0x23F}, {7, 0x23F},
    {4, 0x607}, {5, 0x607}, {4, 0x60F}, {5, 0x60F}, {4, 0x20F}, {5, 0x20F},
};

/* LP -> HP post-buck (steps 7-8). */
static const struct trim_write trim_lp_to_hp_post[] = {
    {0, 0x343}, {1, 0x343}, {2, 0x206}, {3, 0x206}, {6, 0x3F},
    {7, 0x3F},	{8, 0xA},   {0, 0x342}, {1, 0x342}, {2, 0x202},
    {3, 0x202}, {4, 0x20B}, {5, 0x20B}, {6, 0x1B},  {7, 0x1B},
};

/* ULP <-> LP trim tables (trim_ulp_to_lp_pre/_post, trim_lp_to_ulp_pre/_post)
 * are intentionally omitted -- see INVESTIGATION_pse84_ulp.md for the
 * analysis. If ULP support is ever revisited, port them verbatim from
 * the DSL PDL's Cy_SysPm_SystemTransition{UlpToLp,LpToUlp} bodies. */

static inline void apply_trim_seq(const struct trim_write *seq, size_t n)
{
	for (size_t i = 0; i < n; i++) {
		SRSS_TRIM_RAM_CTL(seq[i].index) = seq[i].value;
	}
}

#define APPLY_TRIM(seq) apply_trim_seq((seq), ARRAY_SIZE(seq))

/* PRIMASK-based IRQ mask/unmask. Chosen over Zephyr's irq_lock (which
 * uses BASEPRI) because BASEPRI does not mask NMI/HardFault/priority-0
 * IRQs; PRIMASK gives a hard guarantee no exception entry fires
 * during the transition window. */
static inline unsigned int pm_irq_disable(void)
{
	unsigned int primask;
	__asm__ __volatile__("mrs %0, primask" : "=r"(primask));
	__asm__ __volatile__("cpsid i" ::: "memory");
	return primask;
}

static inline void pm_irq_restore(unsigned int primask)
{
	__asm__ __volatile__("msr primask, %0" : : "r"(primask) : "memory");
}

/* -------------------------------------------------------------------
 * One-step HP <-> LP transition. z_pm S handles the HF0 divider and
 * the CoreBuck profile change atomically inside the psa_call. NS
 * applies SRAM_TRIM around the psa_call because PPC restricts the
 * RAM_TRIM_SRSS_SRAM region to Master-0 (NS).
 *
 * The whole sequence runs with IRQs masked (PRIMASK) to prevent
 * exception entry in the voltage-transition window.
 * ------------------------------------------------------------------- */

static int step_transition(pm_mode_t source, pm_mode_t target,
			   const struct trim_write *pre, size_t pre_n,
			   const struct trim_write *post, size_t post_n)
{
	psa_status_t psa_rc;
	int32_t s_rc = 0;
	unsigned int key;

	key = pm_irq_disable();
	apply_trim_seq(pre, pre_n);
	psa_rc = z_pm_switch_active_mode(source, target, &s_rc);
	if (psa_rc == PSA_SUCCESS && s_rc == 0) {
		apply_trim_seq(post, post_n);
	}
	pm_irq_restore(key);

	return (psa_rc == PSA_SUCCESS && s_rc == 0) ? 0 : -EIO;
}

static int step_hp_to_lp(void)
{
	return step_transition(PM_MODE_HP, PM_MODE_LP,
			       trim_hp_to_lp_pre, ARRAY_SIZE(trim_hp_to_lp_pre),
			       trim_hp_to_lp_post,
			       ARRAY_SIZE(trim_hp_to_lp_post));
}

static int step_lp_to_hp(void)
{
	return step_transition(PM_MODE_LP, PM_MODE_HP,
			       trim_lp_to_hp_pre, ARRAY_SIZE(trim_lp_to_hp_pre),
			       trim_lp_to_hp_post,
			       ARRAY_SIZE(trim_lp_to_hp_post));
}

int pm_switch_to(pm_mode_t target)
{
	pm_mode_t source;
	uint32_t t_start, t_end, cycles;
	int rc;

	if (target != PM_MODE_HP && target != PM_MODE_LP) {
		if (target == PM_MODE_ULP) {
			printk("[pm] ULP is not supported on this build. "
			       "See INVESTIGATION_pse84_ulp.md.\n");
			return -ENOTSUP;
		}
		return -EINVAL;
	}
	if (target == s_current_mode) {
		return 0;
	}

	source = s_current_mode;

	t_start = k_cycle_get_32();
	gpio_indicators_transition_begin();

	rc = 0;
	if (source == PM_MODE_HP && target == PM_MODE_LP) {
		rc = step_hp_to_lp();
	} else if (source == PM_MODE_LP && target == PM_MODE_HP) {
		rc = step_lp_to_hp();
	} else {
		rc = -EINVAL;
	}

	gpio_indicators_transition_end();
	t_end = k_cycle_get_32();

	if (rc != 0) {
		printk("[pm] switch %s -> %s failed (%d)\n",
		       pm_mode_short(source), pm_mode_short(target), rc);
		return rc;
	}

	s_current_mode = target;

	cycles = t_end - t_start;
	printk("[pm] transition %s -> %s : %u LPTIMER cycles (@32768 Hz)\n",
	       pm_mode_short(source), pm_mode_short(target), cycles);
	return 0;
}

void pm_clock_probe(void)
{
	struct z_pm_clock_probe report;
	psa_status_t psa_rc;

	psa_rc = z_pm_clock_probe(&report);
	if (psa_rc != PSA_SUCCESS) {
		printk("[clk] psa_call failed: status=%d\n", (int)psa_rc);
		return;
	}

	printk("[clk] DPLL_LP0  meas=%3u.%03u MHz (%9u Hz)  "
	       "comp=%3u.%03u MHz (%9u Hz)\n",
	       report.meas_path0 / 1000000u,
	       (report.meas_path0 / 1000u) % 1000u, report.meas_path0,
	       report.comp_path0 / 1000000u,
	       (report.comp_path0 / 1000u) % 1000u, report.comp_path0);
	printk("[clk] CLK_HF0   meas=%3u.%03u MHz (%9u Hz)  "
	       "comp=%3u.%03u MHz (%9u Hz)\n",
	       report.meas_hf0 / 1000000u, (report.meas_hf0 / 1000u) % 1000u,
	       report.meas_hf0, report.comp_hf0 / 1000000u,
	       (report.comp_hf0 / 1000u) % 1000u, report.comp_hf0);
	printk("[clk] CLK_HF10  meas=%3u.%03u MHz (%9u Hz)  "
	       "comp=%3u.%03u MHz (%9u Hz)\n",
	       report.meas_hf10 / 1000000u, (report.meas_hf10 / 1000u) % 1000u,
	       report.meas_hf10, report.comp_hf10 / 1000000u,
	       (report.comp_hf10 / 1000u) % 1000u, report.comp_hf10);
}
```

## src/z_pm_client.c
```c
/*
 * Copyright (c) 2026
 * SPDX-License-Identifier: Apache-2.0
 *
 * NS-side stubs for the z_pm out-of-tree TF-M partition. Marshals args
 * into PSA invecs/outvecs and calls the partition's stateless service
 * handle (Z_PM_SERVICE_HANDLE from psa_manifest/sid.h).
 */

#include <stdint.h>

#include "psa/client.h"
#include "psa_manifest/sid.h"

#include "z_pm_client.h"

#ifndef IOVEC_LEN
#define IOVEC_LEN(x) (sizeof(x) / sizeof((x)[0]))
#endif

psa_status_t z_pm_ping(uint32_t *out_cookie)
{
	if (out_cookie == NULL) {
		return PSA_ERROR_INVALID_ARGUMENT;
	}

	psa_outvec out_vec[] = {
	    {.base = out_cookie, .len = sizeof(*out_cookie)},
	};

	return psa_call(Z_PM_SERVICE_HANDLE, Z_PM_OP_PING, NULL, 0, out_vec,
			IOVEC_LEN(out_vec));
}

psa_status_t z_pm_layer_b_init(void)
{
	return psa_call(Z_PM_SERVICE_HANDLE, Z_PM_OP_LAYER_B_INIT, NULL, 0,
			NULL, 0);
}

psa_status_t z_pm_set_deep_sleep_mode(uint32_t mode)
{
	psa_invec in_vec[] = {
	    {.base = &mode, .len = sizeof(mode)},
	};

	return psa_call(Z_PM_SERVICE_HANDLE, Z_PM_OP_SET_DEEP_SLEEP_MODE,
			in_vec, IOVEC_LEN(in_vec), NULL, 0);
}

psa_status_t z_pm_switch_active_mode(uint32_t source, uint32_t target,
				     int32_t *out_rc)
{
	struct z_pm_switch_in in = {.source = source, .target = target};
	struct z_pm_switch_out out = {.status = 0};
	psa_status_t st;

	if (out_rc == NULL) {
		return PSA_ERROR_INVALID_ARGUMENT;
	}

	psa_invec in_vec[] = {
	    {.base = &in, .len = sizeof(in)},
	};
	psa_outvec out_vec[] = {
	    {.base = &out, .len = sizeof(out)},
	};

	st = psa_call(Z_PM_SERVICE_HANDLE, Z_PM_OP_SWITCH_ACTIVE_MODE, in_vec,
		      IOVEC_LEN(in_vec), out_vec, IOVEC_LEN(out_vec));
	*out_rc = out.status;
	return st;
}

psa_status_t z_pm_clock_probe(struct z_pm_clock_probe *report)
{
	if (report == NULL) {
		return PSA_ERROR_INVALID_ARGUMENT;
	}

	psa_outvec out_vec[] = {
	    {.base = report, .len = sizeof(*report)},
	};

	return psa_call(Z_PM_SERVICE_HANDLE, Z_PM_OP_CLOCK_PROBE, NULL, 0,
			out_vec, IOVEC_LEN(out_vec));
}

psa_status_t z_pm_deep_sleep_bias(void)
{
	return psa_call(Z_PM_SERVICE_HANDLE, Z_PM_OP_DEEP_SLEEP_BIAS, NULL, 0,
			NULL, 0);
}

psa_status_t z_pm_boot_clock_retune(void)
{
	return psa_call(Z_PM_SERVICE_HANDLE, Z_PM_OP_BOOT_CLOCK_RETUNE, NULL, 0,
			NULL, 0);
}
```
