## CMakeLists.txt
```
cmake_minimum_required(VERSION 3.20.0)

find_package(Zephyr REQUIRED HINTS $ENV{ZEPHYR_BASE})
project(cm33_s_blinki)

target_sources(app PRIVATE
	src/main.c
	src/pse84_boot_local.c
)
```

## prj.conf
```kconfig
CONFIG_BUILD_OUTPUT_HEX=y
CONFIG_GPIO=y

# CM55 owns the shared console UART (uart2). Disable serial on CM33-S
# so the peripheral is not claimed by both cores.
CONFIG_SERIAL=n
CONFIG_CONSOLE=n
CONFIG_UART_CONSOLE=n

# Do NOT set CONFIG_SOC_PSE84_M55_ENABLE: that would pull in the upstream
# ifx_pse84_cm55_startup() (via soc_late_init_hook) which ends in a
# tight for(;;) loop. Our local copy in src/pse84_boot_local.c is called
# from main() instead, so the CM33-S returns and keeps running Zephyr.

# No TF-M.
CONFIG_BUILD_WITH_TFM=n
```

## src/main.c
```c
/*
 * Copyright (c) 2026
 *
 * SPDX-License-Identifier: Apache-2.0
 *
 * CM33-Secure blinky for kit_pse84_eval. Blinks the red LED (led0)
 * at 1 Hz after releasing the CM55 core through a local copy of the
 * PSE84 secure boot code (src/pse84_boot_local.c) which returns
 * instead of trapping the CM33 in for(;;).
 */

#include <zephyr/drivers/gpio.h>
#include <zephyr/kernel.h>

#include "pse84_boot_local.h"

#define BLINK_PERIOD_MS 500

static const struct gpio_dt_spec led = GPIO_DT_SPEC_GET(DT_ALIAS(led0), gpios);

int main(void)
{
	app_pse84_cm55_startup();

	if (!gpio_is_ready_dt(&led)) {
		return 0;
	}

	if (gpio_pin_configure_dt(&led, GPIO_OUTPUT_ACTIVE) < 0) {
		return 0;
	}

	while (1) {
		gpio_pin_toggle_dt(&led);
		k_msleep(BLINK_PERIOD_MS);
	}

	return 0;
}
```

## src/pse84_boot_local.c
```c
/*
 * Copyright (c) 2026
 *
 * SPDX-License-Identifier: Apache-2.0
 *
 * Local variant of upstream:
 *   zephyr/soc/infineon/edge/pse84/security_config/pse84_boot.c
 *
 * Differences vs. upstream ifx_pse84_cm55_startup():
 *   - Renamed to app_pse84_cm55_startup() so it never clashes with the
 *     upstream symbol (which is only defined when
 *     CONFIG_SOC_PSE84_M55_ENABLE=y).
 *   - Does NOT call sys_clock_disable(): the CM33-Secure must keep
 *     SysTick running so the Zephyr scheduler can drive its own threads
 *     (e.g. the red-LED blink loop) after CM55 has been released.
 *   - Does NOT trap the caller in for(;;): returns so main() can
 *     continue executing.
 *
 * All other steps (SysCtrlBlk / NVIC-NS / FPU-NS setup, PD1 enable,
 * TCM + SMIF peri-group init, MPC config, PDCM dependency clears,
 * Cy_SysEnableCM55, deep-sleep mode config, PPC0/PPC1 init) match
 * upstream verbatim so that CM55 comes up in the same environment as
 * a stock sysbuild "enable_cm55" companion.
 */

#include <zephyr/kernel.h>

#include <cy_pdl.h>
#include <system_edge.h>
#include <partition_ARMCM33.h>

#include "pse84_s_mpc.h"
#include "pse84_s_protection.h"
#include "pse84_s_system.h"

#include "pse84_boot_local.h"

#define CM55_BOOT_WAIT_TIME_USEC (10U)

void app_pse84_cm55_startup(void)
{
	SysCtrlBlk_Setup();
	NVIC_NS_Setup();

#if defined(__FPU_USED) && (__FPU_USED == 1U) && defined(TZ_FPU_NS_USAGE) &&   \
    (TZ_FPU_NS_USAGE == 1U)
	initFPU();
#endif

	__enable_irq();

	Cy_System_EnablePD1();

	Cy_SysClk_PeriGroupSlaveInit(
	    CY_MMIO_CM55_TCM_512K_PERI_NR, CY_MMIO_CM55_TCM_512K_GROUP_NR,
	    CY_MMIO_CM55_TCM_512K_SLAVE_NR, CY_MMIO_CM55_TCM_512K_CLK_HF_NR);

	Cy_SysClk_PeriGroupSlaveInit(
	    CY_MMIO_SMIF0_PERI_NR, CY_MMIO_SMIF0_GROUP_NR,
	    CY_MMIO_SMIF0_SLAVE_NR, CY_MMIO_SMIF0_CLK_HF_NR);

	cy_mpc_init();

	cy_pd_pdcm_clear_dependency(CY_PD_PDCM_APPCPUSS, CY_PD_PDCM_SYSCPU);
	cy_pd_pdcm_clear_dependency(CY_PD_PDCM_APPCPU, CY_PD_PDCM_SYSCPU);

	uint32_t cm55_start_address = DT_REG_ADDR(DT_NODELABEL(m55_xip));

	Cy_SysEnableCM55(MXCM55, cm55_start_address, CM55_BOOT_WAIT_TIME_USEC);

	Cy_SysPm_SetDeepSleepMode(CY_SYSPM_MODE_DEEPSLEEP);
	Cy_SysPm_SetSOCMEMDeepSleepMode(CY_SYSPM_MODE_DEEPSLEEP);

	cy_ppc0_init();
	cy_ppc1_init();
}
```

## src/pse84_boot_local.h
```c
/*
 * Copyright (c) 2026
 *
 * SPDX-License-Identifier: Apache-2.0
 */

#ifndef APP_PSE84_BOOT_LOCAL_H_
#define APP_PSE84_BOOT_LOCAL_H_

#ifdef __cplusplus
extern "C" {
#endif

/*
 * Local variant of upstream ifx_pse84_cm55_startup(). Configures the
 * secure/non-secure partitioning (MPC/PPC), enables PD1, releases the
 * CM55 core, and RETURNS so the caller can continue executing.
 */
void app_pse84_cm55_startup(void);

#ifdef __cplusplus
}
#endif

#endif /* APP_PSE84_BOOT_LOCAL_H_ */
```
