## prj.conf
```kconfig
CONFIG_BUILD_OUTPUT_HEX=y
CONFIG_GPIO=y

# No TF-M SPE running on the CM33 side, so the CM55 must not enable
# the SRF/mailbox relay to it. Keeping this off also drops the paired-
# build header dependency (PSE84_CM33_BUILD_DIR).
# CONFIG_PSOC_EDGE_M55_SRF_SUPPORT is not set

# No TF-M.
CONFIG_BUILD_WITH_TFM=n
```

## src/main.c
```c
/*
 * Copyright (c) 2026
 *
 * SPDX-License-Identifier: Apache-2.0
 *
 * CM55 blinky for kit_pse84_eval. Blinks the green LED (led1)
 * at ~2 Hz so it is visually distinguishable from the CM33-S red
 * LED (led0) running at 1 Hz.
 */

#include <stdio.h>
#include <zephyr/drivers/gpio.h>
#include <zephyr/kernel.h>

#define BLINK_PERIOD_MS 250

static const struct gpio_dt_spec led = GPIO_DT_SPEC_GET(DT_ALIAS(led1), gpios);

int main(void)
{
	printf("CM55 blinky on %s\n", CONFIG_BOARD);

	if (!gpio_is_ready_dt(&led)) {
		printf("CM55: led1 not ready\n");
		return 0;
	}

	if (gpio_pin_configure_dt(&led, GPIO_OUTPUT_ACTIVE) < 0) {
		printf("CM55: failed to configure led1\n");
		return 0;
	}

	while (1) {
		gpio_pin_toggle_dt(&led);
		k_msleep(BLINK_PERIOD_MS);
	}

	return 0;
}
```
