## prj.conf
```kconfig
CONFIG_MAIN_STACK_SIZE=2048
CONFIG_BT=y
CONFIG_BT_PERIPHERAL=y

CONFIG_BT_DIS=y
CONFIG_BT_DIS_PNP=n
CONFIG_BT_DIS_MODEL_NUMBER=y
CONFIG_BT_DIS_MANUF_NAME=y
CONFIG_BT_DIS_SERIAL_NUMBER=y
CONFIG_BT_DIS_FW_REV=y
CONFIG_BT_DIS_HW_REV=y
CONFIG_BT_DIS_SW_REV=y
CONFIG_BT_DIS_MODEL_NUMBER_STR="Zephyr Model"
CONFIG_BT_DIS_MANUF_NAME_STR="Zephyr"
CONFIG_BT_DIS_SERIAL_NUMBER_STR="Zephyr Serial"
CONFIG_BT_DIS_FW_REV_STR="Zephyr Firmware"
CONFIG_BT_DIS_HW_REV_STR="Zephyr Hardware"
CONFIG_BT_DIS_SW_REV_STR="Zephyr Software"

CONFIG_BT_DIS_UDI=y
CONFIG_BT_DIS_UDI_LABEL_STR="Zephyr Test UDI Label"
CONFIG_BT_DIS_UDI_DI_STR="(01)0123456789ABCD(11)241125(17)341125(10)A1234(21)0123456789"
CONFIG_BT_DIS_UDI_ISSUER_STR="1.3.6.1.4.1.99999"
CONFIG_BT_DIS_UDI_AUTHORITY_STR="1.3.6.1.4.1.99999"

CONFIG_BT_DIS_PNP=y
CONFIG_BT_DIS_PNP_VID_SRC=1
CONFIG_BT_DIS_PNP_VID=0xFFFF
CONFIG_BT_DIS_PNP_PID=0xFFFF
CONFIG_BT_DIS_PNP_VER=0

CONFIG_BT_DIS_SYSTEM_ID=y
CONFIG_BT_DIS_SYSTEM_ID_OUI=0xFFFFFF
CONFIG_BT_DIS_SYSTEM_ID_IDENTIFIER=0xFFFFFFFFFF

CONFIG_BT_DIS_IEEE_RCDL=y
CONFIG_BT_DIS_IEEE_RCDL_STR="Zephyr Test IEEE RCDL"

CONFIG_BT_DEVICE_NAME="DIS peripheral"

# Below is setup to let DIS information be read from settings
CONFIG_BT_SETTINGS=y
CONFIG_SETTINGS_RUNTIME=y
CONFIG_SETTINGS=y
CONFIG_SETTINGS_NONE=y

CONFIG_BT_DIS_SETTINGS=y
CONFIG_BT_DIS_STR_MAX=100
```

## boards/kit_pse84_ai_pse846gps2dbzc4a_m33.conf
```kconfig
# Board-specific Kconfig fragment for kit_pse84_ai (M33).
# Auto-applied by the build system when this board target is selected.

# Select the AIROC chip + module actually on the KIT_PSE84_AI board.
# The upstream board Kconfig.defconfig only sets these on the M55 target;
# for M33 we must pin them here so CMake picks the CYW55513/MURATA-2FY
# firmware blob rather than falling back to CYW4343W.
CONFIG_CYW55500=y
CONFIG_CYW55513_MURATA_2FY=y

# Minimal logging at INF level so we can see host-level progress.
# Keep IMMEDIATE mode — this is the mode that worked for HCI_RESET.
CONFIG_LOG=y
CONFIG_LOG_MODE_IMMEDIATE=y
CONFIG_BT_LOG_LEVEL_INF=y
CONFIG_BT_HCI_DRIVER_LOG_LEVEL_INF=y
```

## boards/kit_pse84_ai_pse846gps2dbzc4a_m33.overlay
```dts
/*
 * Board overlay for kit_pse84_ai (M33) — CYW55513 HCI bring-up.
 *
 * NOTE: hw-flow-control on scb4 is REQUIRED by drivers/bluetooth/hci/
 * hci_uart_infineon.c (BUILD_ASSERT). Do not disable it here.
 *
 * Placeholder overlay reserved for board-scoped diagnostic tweaks.
 */
```

## src/main.c
```c
/* main.c - Application main entry point */

/*
 * Copyright (c) 2015-2016 Intel Corporation
 *
 * SPDX-License-Identifier: Apache-2.0
 */

#include <zephyr/types.h>
#include <stddef.h>
#include <string.h>
#include <errno.h>
#include <zephyr/sys/printk.h>
#include <zephyr/sys/byteorder.h>
#include <zephyr/kernel.h>

#include <zephyr/bluetooth/bluetooth.h>
#include <zephyr/bluetooth/hci.h>
#include <zephyr/bluetooth/conn.h>
#include <zephyr/bluetooth/uuid.h>
#include <zephyr/bluetooth/gatt.h>
#include <zephyr/settings/settings.h>

static const struct bt_data ad[] = {
    BT_DATA_BYTES(BT_DATA_FLAGS, (BT_LE_AD_GENERAL | BT_LE_AD_NO_BREDR)),
    BT_DATA_BYTES(BT_DATA_UUID16_ALL, BT_UUID_16_ENCODE(BT_UUID_DIS_VAL)),
};

static const struct bt_data sd[] = {
    BT_DATA(BT_DATA_NAME_COMPLETE, CONFIG_BT_DEVICE_NAME,
	    sizeof(CONFIG_BT_DEVICE_NAME) - 1),
};

static void connected(struct bt_conn *conn, uint8_t err)
{
	if (err) {
		printk("Connection failed, err 0x%02x %s\n", err,
		       bt_hci_err_to_str(err));
	} else {
		printk("Connected\n");
	}
}

static void disconnected(struct bt_conn *conn, uint8_t reason)
{
	printk("Disconnected, reason 0x%02x %s\n", reason,
	       bt_hci_err_to_str(reason));
}

BT_CONN_CB_DEFINE(conn_callbacks) = {
    .connected = connected,
    .disconnected = disconnected,
};

static int settings_runtime_load(void)
{
#if defined(CONFIG_BT_DIS_SETTINGS)
	settings_runtime_set("bt/dis/model", "Zephyr Model",
			     sizeof("Zephyr Model"));
	settings_runtime_set("bt/dis/manuf", "Zephyr Manufacturer",
			     sizeof("Zephyr Manufacturer"));
#if defined(CONFIG_BT_DIS_SERIAL_NUMBER)
	settings_runtime_set("bt/dis/serial", CONFIG_BT_DIS_SERIAL_NUMBER_STR,
			     sizeof(CONFIG_BT_DIS_SERIAL_NUMBER_STR));
#endif
#if defined(CONFIG_BT_DIS_SW_REV)
	settings_runtime_set("bt/dis/sw", CONFIG_BT_DIS_SW_REV_STR,
			     sizeof(CONFIG_BT_DIS_SW_REV_STR));
#endif
#if defined(CONFIG_BT_DIS_FW_REV)
	settings_runtime_set("bt/dis/fw", CONFIG_BT_DIS_FW_REV_STR,
			     sizeof(CONFIG_BT_DIS_FW_REV_STR));
#endif
#if defined(CONFIG_BT_DIS_HW_REV)
	settings_runtime_set("bt/dis/hw", CONFIG_BT_DIS_HW_REV_STR,
			     sizeof(CONFIG_BT_DIS_HW_REV_STR));
#endif
#endif
	return 0;
}

int main(void)
{
	int err;

	printk("main: calling bt_enable\n");
	err = bt_enable(NULL);
	printk("main: bt_enable returned %d\n", err);
	if (err) {
		printk("Bluetooth init failed (err %d)\n", err);
		return 0;
	}

	if (IS_ENABLED(CONFIG_BT_SETTINGS)) {
		settings_load();
	}

	settings_runtime_load();

	printk("Bluetooth initialized\n");

	err = bt_le_adv_start(BT_LE_ADV_CONN_FAST_1, ad, ARRAY_SIZE(ad), sd,
			      ARRAY_SIZE(sd));
	if (err) {
		printk("Advertising failed to start (err %d)\n", err);
		return 0;
	}

	printk("Advertising successfully started\n");
	return 0;
}
```
