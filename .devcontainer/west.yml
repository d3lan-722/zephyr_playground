## .devcontainer/west.yml
```yaml
# Custom west manifest for radar project devcontainer.
# Imports only the Zephyr modules needed by this project to reduce
# container build time and size.
#
# To add support for new hardware, add the required HAL to name-allowlist
# below, then sync and pull the new module:
#   cp /workspaces/z_playground/.devcontainer/west.yml /home/ubuntu/zephyrproject/manifest-repo/west.yml
#   cd /home/ubuntu/zephyrproject && west update
manifest:
  remotes:
    - name: zephyrproject-rtos
      url-base: https://github.com/zephyrproject-rtos
    - name: sensor-xensiv-bgt60trxx
      url-base: https://github.com/Infineon
    - name: coremark-pro
      url-base: https://github.com/eembc
    - name: mtb-example-psoc-edge-power-measurements
      url-base: https://github.com/Infineon
    - name: mtb-example-psoc-edge-secure-power-management
      url-base: https://github.com/Infineon
    - name: se-rt-services-utils
      url-base: https://github.com/Infineon
    - name: ifx-l1-boot
      url-base: https://gitlab.intra.infineon.com/repo/cy_mcuboot_project
  projects:
    - name: zephyr
      remote: zephyrproject-rtos
      revision: main
      clone-depth: 1
      import:
        name-allowlist:
          - cmsis                # ARM CMSIS headers (required for all ARM targets)
          - cmsis_6              # CMSIS v6 core headers (cmsis_core.h, required for Cortex-M)
          - hal_infineon         # Infineon PSoC 6 + PSE84 HAL
          - mcuboot              # MCUboot bootloader (provides imgtool for image signing)
          - mbedtls              # TLS/crypto library
          - net-tools            # Networking utilities (used by PPP app)
          - picolibc             # C library
          - tf-m-tests           # TF-M test sources (required by trusted-firmware-m module)
          - tf-psa-crypto        # PSA crypto implementation (required by mbedtls)
          - trusted-firmware-m   # TF-M secure firmware (required for PSOC_EDGE_M55_SRF_SUPPORT)
    - name: sensor-xensiv-bgt60trxx
      remote: sensor-xensiv-bgt60trxx
      revision: master
      clone-depth: 1
    - name: coremark-pro
      remote: coremark-pro
      revision: main
      clone-depth: 1
    - name: mtb-example-psoc-edge-power-measurements
      remote: mtb-example-psoc-edge-power-measurements
      revision: master
      clone-depth: 1
    - name: mtb-example-psoc-edge-secure-power-management
      remote: mtb-example-psoc-edge-secure-power-management
      revision: master
      clone-depth: 1
    - name: se-rt-services-utils
      remote: se-rt-services-utils
      revision: release-v1.2.0
      clone-depth: 1
    - name: L1-boot
      remote: ifx-l1-boot
      revision: develop
      clone-depth: 1

  self:
    path: manifest-repo
```

## apps/10_pse84_m33_clock_management/twister-out.3/kit_pse84_ai_pse846gps2dbzc4a_m55/zephyr_gnu/workspaces/z_playground/apps/10_pse84_m33_clock_management/tests/integration_runtime/dummy.testing.ztest/Kconfig/boards/Kconfig.sysbuild
```kconfig
# Load Sysbuild board Kconfig descriptions.
osource "/home/ubuntu/zephyrproject/zephyr/boards/infineon/kit_pse84_ai/Kconfig.sysbuild"
```

## apps/10_pse84_m33_clock_management/twister-out.4/kit_pse84_ai_pse846gps2dbzc4a_m55/zephyr_gnu/workspaces/z_playground/apps/10_pse84_m33_clock_management/tests/integration_runtime/dummy.testing.ztest/Kconfig/boards/Kconfig.defconfig
```kconfig
# Load Zephyr board defconfig descriptions.
osource "/home/ubuntu/zephyrproject/zephyr/boards/infineon/kit_pse84_ai/Kconfig.defconfig"
```

## apps/10_pse84_m33_clock_management/twister-out.4/kit_pse84_ai_pse846gps2dbzc4a_m55/zephyr_gnu/workspaces/z_playground/apps/10_pse84_m33_clock_management/tests/integration_runtime/dummy.testing.ztest/enable_cm55/Kconfig/Kconfig.sysbuild.modules
```kconfig
config ZEPHYR_CMSIS_MODULE
   bool
   default y
config ZEPHYR_CMSIS_6_MODULE
   bool
   default y
config ZEPHYR_HAL_INFINEON_MODULE
   bool
   default y
config ZEPHYR_MBEDTLS_MODULE
   bool
   default y
config ZEPHYR_MCUBOOT_MODULE
   bool
   default y
config ZEPHYR_PICOLIBC_MODULE
   bool
   default y
config ZEPHYR_TF_M_TESTS_MODULE
   bool
   default y
config ZEPHYR_TF_PSA_CRYPTO_MODULE
   bool
   default y
config ZEPHYR_TRUSTED_FIRMWARE_M_MODULE
   bool
   default y
```

## apps/10_pse84_m33_clock_management/twister-out.6/kit_pse84_ai_pse846gps2dbzc4a_m55/zephyr_gnu/workspaces/z_playground/apps/10_pse84_m33_clock_management/tests/integration_runtime/dummy.testing.ztest/integration_runtime/Kconfig/Kconfig.modules
```kconfig
menu "cmsis (/home/ubuntu/zephyrproject/modules/hal/cmsis)"
osource "$(ZEPHYR_CMSIS_KCONFIG)"
config ZEPHYR_CMSIS_MODULE
	bool
	default y
endmenu
menu "cmsis_6 (/home/ubuntu/zephyrproject/modules/hal/cmsis_6)"
osource "$(ZEPHYR_CMSIS_6_KCONFIG)"
config ZEPHYR_CMSIS_6_MODULE
	bool
	default y
endmenu
menu "hal_infineon (/home/ubuntu/zephyrproject/modules/hal/infineon)"
osource "$(ZEPHYR_HAL_INFINEON_KCONFIG)"
config ZEPHYR_HAL_INFINEON_MODULE
	bool
	default y
	select TAINT_BLOBS

config ZEPHYR_HAL_INFINEON_MODULE_BLOBS
	bool
	default y
endmenu
menu "mbedtls (/home/ubuntu/zephyrproject/modules/crypto/mbedtls)"
osource "$(ZEPHYR_MBEDTLS_KCONFIG)"
config ZEPHYR_MBEDTLS_MODULE
	bool
	default y
endmenu
config ZEPHYR_MCUBOOT_MODULE
	bool
	default y
menu "picolibc (/home/ubuntu/zephyrproject/modules/lib/picolibc)"
osource "/home/ubuntu/zephyrproject/modules/lib/picolibc/zephyr/Kconfig"
config ZEPHYR_PICOLIBC_MODULE
	bool
	default y
endmenu
config ZEPHYR_TF_M_TESTS_MODULE
	bool
	default y
config ZEPHYR_TF_PSA_CRYPTO_MODULE
	bool
	default y
menu "trusted-firmware-m (/home/ubuntu/zephyrproject/modules/tee/tf-m/trusted-firmware-m)"
osource "$(ZEPHYR_TRUSTED_FIRMWARE_M_KCONFIG)"
config ZEPHYR_TRUSTED_FIRMWARE_M_MODULE
	bool
	default y
endmenu
```

## apps/10_pse84_m33_clock_management/twister-out.6/kit_pse84_ai_pse846gps2dbzc4a_m55/zephyr_gnu/workspaces/z_playground/apps/10_pse84_m33_clock_management/tests/integration_runtime/dummy.testing.ztest/integration_runtime/Kconfig/arch/Kconfig
```kconfig
# Load Zephyr Arch Kconfig descriptions.
osource "/home/ubuntu/zephyrproject/zephyr/arch/rx/Kconfig"
osource "/home/ubuntu/zephyrproject/zephyr/arch/x86/Kconfig"
osource "/home/ubuntu/zephyrproject/zephyr/arch/xtensa/Kconfig"
osource "/home/ubuntu/zephyrproject/zephyr/arch/sparc/Kconfig"
osource "/home/ubuntu/zephyrproject/zephyr/arch/riscv/Kconfig"
osource "/home/ubuntu/zephyrproject/zephyr/arch/posix/Kconfig"
osource "/home/ubuntu/zephyrproject/zephyr/arch/openrisc/Kconfig"
osource "/home/ubuntu/zephyrproject/zephyr/arch/mips/Kconfig"
osource "/home/ubuntu/zephyrproject/zephyr/arch/arm64/Kconfig"
osource "/home/ubuntu/zephyrproject/zephyr/arch/arm/Kconfig"
osource "/home/ubuntu/zephyrproject/zephyr/arch/arc/Kconfig"
```

## modules/bgt60tr13c/drivers/bgt60tr13c/Kconfig
```kconfig
# Create a new option in menuconfig for enabling the BGT60TR13C RADAR driver
config BGT60TR13C
    bool "Enable Infineon BGT60TR13C RADAR Sensor Driver"
    default n # Disable by default
    depends on SPI && GPIO # Ensure SPI and GPIO support are available
    help
      Enable this option to include the Infineon BGT60TR13C 60GHz RADAR sensor driver in the build.
      This driver provides support for the BGT60TR13C RADAR sensor which can detect motion,
      presence, and range measurements.

if BGT60TR13C

config BGT60TR13C_INIT_PRIORITY
    int "BGT60TR13C init priority"
    default 90
    help
      Device driver init priority. Must run after CONFIG_SPI_INIT_PRIORITY
      and after the GPIO controllers used for reset-gpios and irq-gpios.
      Lower numbers init earlier.

endif # BGT60TR13C
```

## modules/bgt60tr13c/dts/bindings/sensor/infineon,bgt60tr13c.yaml
```yaml
description: |
  Infineon BGT60TR13C 60 GHz FMCW radar sensor.

  Standard SPI-child properties (reg, spi-max-frequency, duplex,
  frame-format, spi-interframe-delay-ns, spi-cpol, spi-cpha, ...) are
  inherited from spi-device.yaml.

compatible: "infineon,bgt60tr13c"

include: spi-device.yaml

properties:
  reset-gpios:
    type: phandle-array
    required: true
    description: Sensor hard reset (RSTN), typically active low.

  irq-gpios:
    type: phandle-array
    required: false
    description: |
      FIFO-ready interrupt output from the sensor. Rising edge when
      FIFO fill level reaches SFCTL.FIFO_CREF. If present the driver
      signals a waiting thread via wait_fifo_ready(); if absent the
      caller must poll get_fifo_status().
```

## modules/pmu/drivers/pmu/Kconfig
```kconfig
config PMU_DVFS
    bool "Enable Infineon generic PMU / DVFS driver"
    default n
    help
      Enable this option to include the driver for the generic
      Power Modeling Unit (PMU) with software-driven DVFS. The
      device is memory-mapped and described in the devicetree with
      the "infineon,pmu-dvfs" compatible.

if PMU_DVFS

config PMU_DVFS_INIT_PRIORITY
    int "PMU DVFS init priority"
    default 90
    help
      Device driver init priority. Lower numbers init earlier.

config PMU_DVFS_LOG_LEVEL
    int "PMU DVFS log level"
    depends on LOG
    range 0 4
    default 3
    help
      Log level for the PMU driver (0=off, 4=debug).

endif # PMU_DVFS
```

## modules/pmu/dts/bindings/pmu/infineon,pmu-dvfs.yaml
```yaml
description: |
  Infineon generic Power Modeling Unit (PMU) with software-driven DVFS.

  The PMU exposes a 64 KB memory-mapped register block with a
  P-state table (up to 10 entries) and a DVFS control engine that
  can be driven either from software (register-driven mode) or from
  a workload-level input signal (signal-driven mode).

  Register map (byte offsets):
    0x0004 DVFSCTRL         DVFS control
    0x0008 DVFSPSTATEREQ    Target P-state request (register-driven)
    0x000C DVFSSTATUS       Current P-state, busy / phase / error
    0x0010 CURRVOLTMV       Current output voltage in mV (RO)
    0x0014 CURRFREQMHZ      Current output frequency in MHz (RO)
    0x0100 + 4*i            DVFSPSTATETABLE_PSTATE[i], i in [0..9]

compatible: "infineon,pmu-dvfs"

include: base.yaml

properties:
  reg:
    required: true

  num-pstates:
    type: int
    default: 10
    description: |
      Number of P-state table entries the driver will program from
      the pstate-table property (1..10). Passed to DVFSCTRL.NUMSTATES
      at init time.

  transition-timeout-us:
    type: int
    default: 100
    description: |
      DVFS transition timeout in microseconds, written to
      DVFSCTRL.TRANSTIMEOUT at init time.

  pstate-table:
    type: array
    required: false
    description: |
      Optional flat list of (freq-MHz, voltage-mV) pairs used to
      preload the P-state table at driver init. Length must be
      2 * num-pstates. Entry i uses index (2*i) as frequency and
      (2*i + 1) as voltage. If omitted, the application must program
      the table via pmu_set_pstate() before enabling DVFS.

  init-enable:
    type: boolean
    description: |
      If present, the driver enables DVFS (DVFSCTRL.DVFSEN=1) at the
      end of init after programming the table, num-states and
      timeout. Requires pstate-table to be set.

  init-pstate:
    type: int
    default: 0
    description: |
      When init-enable is set, the driver writes this P-state to
      DVFSPSTATEREQ after enabling DVFS to drive the first target.
```
